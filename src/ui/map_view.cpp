#include <Arduino.h>
#include "map_view.h"
#include "detail_card.h"
#include "views.h"
#include "range.h"
#include "filters.h"
#include "aircraft_icons.h"
// #include "tile_cache.h" // disabled: tiles broken on ESP32-P4
#include "../pins_config.h"
#include "../data/storage.h"
#include "../data/fetcher.h"
#include "../data/error_log.h"
#include "../data/locations.h"

// Static pre-rendered map background (generated by tools/generate_static_map.py)
#if __has_include("static_map_data.h")
#include "static_map_data.h"
#define HAS_STATIC_MAP 1
#else
#define HAS_STATIC_MAP 0
#endif

// Static large/medium airport glyph DB (generated by tools/generate_airports_db.py)
#if __has_include("airports_db.h")
#include "airports_db.h"
#define HAS_AIRPORTS_DB 1
#else
#define HAS_AIRPORTS_DB 0
#endif

static AircraftList *_list = nullptr;      // currently effective list (home or active saved location)
static AircraftList *_home_list = nullptr; // the list passed in at init — always the home feed
static int _last_active_loc = -2;          // sentinel so the first tick always syncs (-1 is a valid "Home")
static lv_obj_t *_canvas = nullptr;
static lv_obj_t *_range_label = nullptr;
static MapProjection _proj;

// Runway label visibility depends on zoom tier (tuned against real airports —
// KDEN's dense runway cluster vs. EGLL's wide-spaced pair vs. KAPA's mixed
// lengths all needed hand-testing, a fixed rule alone couldn't get it right):
//   > 10nm: no labels at all — too little screen space to label without
//           just being clutter on top of the runway lines themselves.
//   <= 10nm: labels in the smaller 10pt font — more room to fit a whole
//            airport's layout without overlap.
//   <= 8nm: labels in the larger, more readable 14pt font — enough room at
//           this zoom to afford it.
#define RUNWAY_LABEL_SHOW_MAX_NM  10.0f
#define RUNWAY_LABEL_BIG_FONT_NM  8.0f
#define RUNWAY_LABEL_MIN_PX_FLOOR 12     // below this the line itself is basically a dot
#define RUNWAY_LABEL_OFFSET       14     // px beyond endpoint along runway axis
#define RUNWAY_LBL_W_SMALL        30     // lv_font_montserrat_10
#define RUNWAY_LBL_H_SMALL        14
#define RUNWAY_LBL_W_BIG          40     // lv_font_montserrat_14
#define RUNWAY_LBL_H_BIG          18
#define COLOR_RUNWAY         lv_color_hex(0x006600)
#define COLOR_RUNWAY_LABEL   lv_color_hex(0x33cc66)

static bool _filter_just_clicked = false; // guard against zoom cycle
static int _drawn_count = 0; // aircraft drawn in last frame, for status bar

// Tracked aircraft — bold red circle until another is selected or it leaves
static char _tracked_hex[7] = {};

#define CANVAS_W LCD_H_RES
#define CANVAS_H (LCD_V_RES - 30)  // minus status bar
#define BG_COLOR lv_color_hex(0x0a0a1a)

// Per-view button/label pointers for filter buttons
static lv_obj_t *_filter_btns[NUM_FILTERS] = {};
static lv_obj_t *_filter_lbls[NUM_FILTERS] = {};

// Loading overlay — shown until first aircraft arrive
static lv_obj_t *_overlay = nullptr;
static lv_obj_t *_overlay_spinner = nullptr;
static lv_obj_t *_overlay_status = nullptr;
static lv_obj_t *_overlay_net = nullptr;
static lv_obj_t *_overlay_stats = nullptr;
static lv_obj_t *_overlay_error = nullptr;
static bool _overlay_dismissed = false;

static void overlay_dismiss_anim_cb(lv_anim_t *a) {
    if (_overlay) {
        lv_obj_delete(_overlay);
        _overlay = nullptr;
        _overlay_spinner = nullptr;
        _overlay_status = nullptr;
        _overlay_net = nullptr;
        _overlay_stats = nullptr;
        _overlay_error = nullptr;
    }
}

static void overlay_dismiss() {
    if (!_overlay || _overlay_dismissed) return;
    _overlay_dismissed = true;

    // Fade out + slide up
    lv_anim_t a;
    lv_anim_init(&a);
    lv_anim_set_var(&a, _overlay);
    lv_anim_set_values(&a, LV_OPA_COVER, LV_OPA_TRANSP);
    lv_anim_set_duration(&a, 400);
    lv_anim_set_exec_cb(&a, [](void *obj, int32_t v) {
        lv_obj_set_style_opa((lv_obj_t *)obj, (lv_opa_t)v, 0);
    });
    lv_anim_set_completed_cb(&a, overlay_dismiss_anim_cb);
    lv_anim_start(&a);

    lv_anim_t a2;
    lv_anim_init(&a2);
    lv_anim_set_var(&a2, _overlay);
    int cur_y = lv_obj_get_y(_overlay);
    lv_anim_set_values(&a2, cur_y, cur_y - 40);
    lv_anim_set_duration(&a2, 400);
    lv_anim_set_exec_cb(&a2, [](void *obj, int32_t v) {
        lv_obj_set_y((lv_obj_t *)obj, (lv_coord_t)v);
    });
    lv_anim_start(&a2);
}

static void overlay_update() {
    if (!_overlay || _overlay_dismissed) return;

    const FetcherStats *fs = fetcher_get_stats();
    NetType net = fetcher_connection_type();

    // Status text
    if (_list->count > 0) {
        overlay_dismiss();
        return;
    }
    if (net == NET_NONE) {
        lv_label_set_text(_overlay_status, "Connecting...");
    } else if (fs->fetch_ok == 0 && fs->fetch_fail == 0) {
        lv_label_set_text(_overlay_status, "Fetching...");
    } else {
        lv_label_set_text(_overlay_status, "Waiting for aircraft...");
    }

    // Network info
    if (net != NET_NONE) {
        const char *type = (net == NET_ETHERNET) ? "ETH" : "WiFi";
        lv_label_set_text_fmt(_overlay_net, "%s  %s", type, fs->ip_addr);
    } else {
        lv_label_set_text(_overlay_net, g_config.use_ethernet ? "Ethernet..." : "WiFi...");
    }

    // Fetch stats
    if (fs->fetch_ok > 0 || fs->fetch_fail > 0) {
        uint32_t kb = fs->bytes_received / 1024;
        lv_label_set_text_fmt(_overlay_stats, "%lu ok / %lu err  %luKB",
            (unsigned long)fs->fetch_ok, (unsigned long)fs->fetch_fail, (unsigned long)kb);
    }

    // Last error
    ErrorSnapshot snap = error_log_snapshot();
    if (snap.count > 0) {
        lv_label_set_text(_overlay_error, snap.entries[snap.count - 1].msg);
        lv_obj_set_style_text_color(_overlay_error, lv_color_hex(0xff6666), 0);
    }
}

static void overlay_create(lv_obj_t *parent) {
    int ow = 320, oh = 200;
    _overlay = lv_obj_create(parent);
    lv_obj_set_size(_overlay, ow, oh);
    lv_obj_set_pos(_overlay, (CANVAS_W - ow) / 2, (CANVAS_H - oh) / 2);
    lv_obj_set_style_bg_color(_overlay, lv_color_hex(0x0a0a1a), 0);
    lv_obj_set_style_bg_opa(_overlay, LV_OPA_90, 0);
    lv_obj_set_style_border_color(_overlay, lv_color_hex(0x4488ff), 0);
    lv_obj_set_style_border_width(_overlay, 1, 0);
    lv_obj_set_style_border_opa(_overlay, LV_OPA_60, 0);
    lv_obj_set_style_radius(_overlay, 12, 0);
    lv_obj_set_style_pad_all(_overlay, 0, 0);
    lv_obj_clear_flag(_overlay, LV_OBJ_FLAG_SCROLLABLE);
    lv_obj_clear_flag(_overlay, LV_OBJ_FLAG_CLICKABLE);
    lv_obj_clear_flag(_overlay, LV_OBJ_FLAG_SCROLL_CHAIN);

    // Spinner (clear clickable — arc widgets eat touches by default)
    _overlay_spinner = lv_spinner_create(_overlay);
    lv_spinner_set_anim_params(_overlay_spinner, 1000, 270);
    lv_obj_clear_flag(_overlay_spinner, LV_OBJ_FLAG_CLICKABLE);
    lv_obj_set_size(_overlay_spinner, 40, 40);
    lv_obj_set_pos(_overlay_spinner, (ow - 40) / 2, 16);
    lv_obj_set_style_arc_color(_overlay_spinner, lv_color_hex(0x4488ff), LV_PART_INDICATOR);
    lv_obj_set_style_arc_color(_overlay_spinner, lv_color_hex(0x1a2a3a), LV_PART_MAIN);
    lv_obj_set_style_arc_width(_overlay_spinner, 4, LV_PART_INDICATOR);
    lv_obj_set_style_arc_width(_overlay_spinner, 4, LV_PART_MAIN);

    // Status text
    _overlay_status = lv_label_create(_overlay);
    lv_label_set_text(_overlay_status, "Connecting...");
    lv_obj_set_style_text_font(_overlay_status, &lv_font_montserrat_20, 0);
    lv_obj_set_style_text_color(_overlay_status, lv_color_hex(0xccccdd), 0);
    lv_obj_set_style_text_align(_overlay_status, LV_TEXT_ALIGN_CENTER, 0);
    lv_obj_set_width(_overlay_status, ow - 20);
    lv_obj_set_pos(_overlay_status, 10, 66);

    // Network type + IP
    _overlay_net = lv_label_create(_overlay);
    lv_label_set_text(_overlay_net, g_config.use_ethernet ? "Ethernet..." : "WiFi...");
    lv_obj_set_style_text_font(_overlay_net, &lv_font_montserrat_14, 0);
    lv_obj_set_style_text_color(_overlay_net, lv_color_hex(0x4488ff), 0);
    lv_obj_set_style_text_align(_overlay_net, LV_TEXT_ALIGN_CENTER, 0);
    lv_obj_set_width(_overlay_net, ow - 20);
    lv_obj_set_pos(_overlay_net, 10, 96);

    // Fetch stats
    _overlay_stats = lv_label_create(_overlay);
    lv_label_set_text(_overlay_stats, "");
    lv_obj_set_style_text_font(_overlay_stats, &lv_font_montserrat_14, 0);
    lv_obj_set_style_text_color(_overlay_stats, lv_color_hex(0x888899), 0);
    lv_obj_set_style_text_align(_overlay_stats, LV_TEXT_ALIGN_CENTER, 0);
    lv_obj_set_width(_overlay_stats, ow - 20);
    lv_obj_set_pos(_overlay_stats, 10, 122);

    // Error line
    _overlay_error = lv_label_create(_overlay);
    lv_label_set_text(_overlay_error, "");
    lv_obj_set_style_text_font(_overlay_error, &lv_font_montserrat_14, 0);
    lv_obj_set_style_text_color(_overlay_error, lv_color_hex(0x666666), 0);
    lv_obj_set_style_text_align(_overlay_error, LV_TEXT_ALIGN_CENTER, 0);
    lv_obj_set_width(_overlay_error, ow - 20);
    lv_obj_set_pos(_overlay_error, 10, 152);
}

static void update_filter_visuals() {
    unsigned active = filter_get_active();
    for (int i = 0; i < NUM_FILTERS; i++) {
        if (active & (1u << i)) {
            lv_obj_set_style_bg_color(_filter_btns[i], filter_defs[i].color, 0);
            lv_obj_set_style_bg_opa(_filter_btns[i], LV_OPA_COVER, 0);
            lv_obj_set_style_border_color(_filter_btns[i], lv_color_hex(0xffffff), 0);
            lv_obj_set_style_border_width(_filter_btns[i], 2, 0);
            lv_obj_set_style_border_opa(_filter_btns[i], LV_OPA_COVER, 0);
            lv_obj_set_style_text_color(_filter_lbls[i], lv_color_hex(0x000000), 0);
        } else {
            lv_obj_set_style_bg_color(_filter_btns[i], lv_color_hex(0x0a0a1a), 0);
            lv_obj_set_style_bg_opa(_filter_btns[i], LV_OPA_70, 0);
            lv_obj_set_style_border_color(_filter_btns[i], filter_defs[i].color, 0);
            lv_obj_set_style_border_width(_filter_btns[i], 1, 0);
            lv_obj_set_style_border_opa(_filter_btns[i], LV_OPA_40, 0);
            lv_obj_set_style_text_color(_filter_lbls[i], lv_color_hex(0x666666), 0);
        }
    }
    if (_canvas) lv_obj_invalidate(_canvas);
}

static void filter_click_cb(lv_event_t *e) {
    int idx = (int)(intptr_t)lv_event_get_user_data(e);
    _filter_just_clicked = true; // prevent zoom cycle
    filter_toggle(idx);
    update_filter_visuals();
}

static void draw_range_rings(lv_layer_t *layer) {
    lv_draw_arc_dsc_t arc_dsc;
    lv_draw_arc_dsc_init(&arc_dsc);
    arc_dsc.color = lv_color_hex(0x1a2a3a);
    arc_dsc.width = 1;
    arc_dsc.start_angle = 0;
    arc_dsc.end_angle = 360;

    float radius_nm = range_get_nm();
    float scale = (float)CANVAS_H / (radius_nm * 2.0f);

    float ring_interval = radius_nm <= 10 ? 2.0f : (radius_nm <= 25 ? 5.0f : 10.0f);
    for (float r = ring_interval; r <= radius_nm; r += ring_interval) {
        int pixel_r = (int)(r * scale);
        arc_dsc.center.x = CANVAS_W / 2 + _proj.offset_x;
        arc_dsc.center.y = CANVAS_H / 2 + _proj.offset_y;
        arc_dsc.radius = pixel_r;
        lv_draw_arc(layer, &arc_dsc);
    }
}

// Marks the current center reference point — home when Home is active, or
// the selected airport's reference point otherwise. Skipped when the active
// location already has its runway diagram drawn — the runways themselves
// mark the airport, and the cross is just clutter on top of them.
static void draw_home_marker(lv_layer_t *layer) {
    int active = locations_active_index();
    if (active != -1) {
        const Location *loc = locations_get(active);
        if (loc && loc->runway_count > 0) return;
    }

    int hx, hy;
    if (!_proj.to_screen(_proj.center_lat, _proj.center_lon, hx, hy)) return;

    lv_draw_line_dsc_t line_dsc;
    lv_draw_line_dsc_init(&line_dsc);
    line_dsc.color = lv_color_hex(0x4488ff);
    line_dsc.width = 1;

    line_dsc.p1 = {(lv_value_precise_t)(hx - 8), (lv_value_precise_t)hy};
    line_dsc.p2 = {(lv_value_precise_t)(hx + 8), (lv_value_precise_t)hy};
    lv_draw_line(layer, &line_dsc);

    line_dsc.p1 = {(lv_value_precise_t)hx, (lv_value_precise_t)(hy - 8)};
    line_dsc.p2 = {(lv_value_precise_t)hx, (lv_value_precise_t)(hy + 8)};
    lv_draw_line(layer, &line_dsc);
}

// Tracks label bounding boxes already drawn this frame (across every saved
// airport being drawn), so a new label can check whether its default spot
// is already busy and try nudging further out instead. Labels always draw —
// dropping a label entirely (whole-airport or individual) turned out to be
// more confusing than a bit of visual overlap in the rare cases that remain.
#define MAX_LABEL_RECTS (MAX_LOCATIONS * MAX_RUNWAYS * 2)
#define LABEL_OVERLAP_LIMIT_PCT 20

// True if the overlap between a and b exceeds LABEL_OVERLAP_LIMIT_PCT of a's
// own area. Not symmetric by construction (a is "the label being tested"),
// but a and b are always same-sized label boxes in practice.
static bool label_areas_overlap_too_much(const lv_area_t &a, const lv_area_t &b) {
    int32_t a_area = (int32_t)(a.x2 - a.x1) * (int32_t)(a.y2 - a.y1);
    int32_t ix1 = a.x1 > b.x1 ? a.x1 : b.x1;
    int32_t iy1 = a.y1 > b.y1 ? a.y1 : b.y1;
    int32_t ix2 = a.x2 < b.x2 ? a.x2 : b.x2;
    int32_t iy2 = a.y2 < b.y2 ? a.y2 : b.y2;
    if (ix2 <= ix1 || iy2 <= iy1) return false; // no intersection at all
    int32_t overlap_area = (ix2 - ix1) * (iy2 - iy1);
    return overlap_area * 100 > a_area * LABEL_OVERLAP_LIMIT_PCT;
}

static lv_area_t label_area_at(int px, int py, int w, int h) {
    return {
        (lv_coord_t)(px - w / 2), (lv_coord_t)(py - h / 2),
        (lv_coord_t)(px + w / 2), (lv_coord_t)(py + h / 2)
    };
}

struct LabelRectSet {
    lv_area_t rects[MAX_LABEL_RECTS];
    int count = 0;

    bool overlaps(const lv_area_t &a) const {
        for (int i = 0; i < count; i++) {
            if (label_areas_overlap_too_much(a, rects[i])) return true;
        }
        return false;
    }

    void add(const lv_area_t &a) {
        if (count < MAX_LABEL_RECTS) rects[count++] = a;
    }
};

// Places a runway-end label near (ex,ey), offset along (dirx,diry) (the unit
// vector pointing away from the runway, out past its end). If the default
// spot overlaps something already drawn, tries pushing further out along the
// same line once; if that's clearer, uses it — otherwise just draws at the
// original spot and accepts the overlap. Always draws.
static void place_runway_label(lv_layer_t *layer, lv_draw_label_dsc_t *lbl, LabelRectSet &placed,
                                int ex, int ey, float dirx, float diry, const char *text, int w, int h) {
    lv_area_t area = label_area_at(ex + (int)(dirx * RUNWAY_LABEL_OFFSET),
                                    ey + (int)(diry * RUNWAY_LABEL_OFFSET), w, h);
    if (placed.overlaps(area)) {
        lv_area_t farther = label_area_at(ex + (int)(dirx * RUNWAY_LABEL_OFFSET * 2),
                                           ey + (int)(diry * RUNWAY_LABEL_OFFSET * 2), w, h);
        if (!placed.overlaps(farther)) area = farther;
        // else: no better spot found nearby — draw at the original spot anyway
    }

    lbl->text = text;
    lv_draw_label(layer, lbl, &area);
    placed.add(area);
}

// Draws runway lines (always) and designators (zoom-tiered — see the
// RUNWAY_LABEL_* constants) for one Location.
static void draw_runways_for(lv_layer_t *layer, const Location *loc, LabelRectSet &placed, float radius_nm) {
    lv_draw_line_dsc_t line;
    lv_draw_line_dsc_init(&line);
    line.color = COLOR_RUNWAY;
    line.width = 1;

    bool show_labels = (radius_nm <= RUNWAY_LABEL_SHOW_MAX_NM);
    bool big_font = (radius_nm <= RUNWAY_LABEL_BIG_FONT_NM);
    int lbl_w = big_font ? RUNWAY_LBL_W_BIG : RUNWAY_LBL_W_SMALL;
    int lbl_h = big_font ? RUNWAY_LBL_H_BIG : RUNWAY_LBL_H_SMALL;
    // Tying this to the label's own width (30-40px) was still too
    // conservative — real short runways (e.g. KAPA's 10/28, ~4800ft) render
    // to ~22px at 10nm and got excluded. This floor exists only to skip
    // genuinely degenerate near-zero-length renders, not to require the
    // runway be wider than its own label.
    int min_px = RUNWAY_LABEL_MIN_PX_FLOOR;

    lv_draw_label_dsc_t lbl;
    if (show_labels) {
        lv_draw_label_dsc_init(&lbl);
        lbl.color = COLOR_RUNWAY_LABEL;
        lbl.font = big_font ? &lv_font_montserrat_14 : &lv_font_montserrat_10;
        lbl.align = LV_TEXT_ALIGN_CENTER;
    }

    for (int i = 0; i < loc->runway_count; i++) {
        const LocRunway &rw = loc->runways[i];
        int x1, y1, x2, y2;
        if (!_proj.to_screen(rw.le_lat, rw.le_lon, x1, y1)) continue;
        if (!_proj.to_screen(rw.he_lat, rw.he_lon, x2, y2)) continue;

        line.p1 = {(lv_value_precise_t)x1, (lv_value_precise_t)y1};
        line.p2 = {(lv_value_precise_t)x2, (lv_value_precise_t)y2};
        lv_draw_line(layer, &line);

        if (!show_labels) continue;

        float vx = (float)(x2 - x1);
        float vy = (float)(y2 - y1);
        float vlen = sqrtf(vx * vx + vy * vy);
        if (vlen < min_px) continue;
        vx /= vlen;
        vy /= vlen;

        place_runway_label(layer, &lbl, placed, x1, y1, -vx, -vy, rw.le_id, lbl_w, lbl_h);
        place_runway_label(layer, &lbl, placed, x2, y2, vx, vy, rw.he_id, lbl_w, lbl_h);
    }
}

#define COLOR_AIRPORT_GLYPH lv_color_hex(0x557799)
#define GLYPH_R 5

// Small "+ ICAO" marker for an airport we don't have runway geometry for —
// either a saved Location with no runway data, or an unsaved airport from
// the static DB.
static void draw_airport_glyph(lv_layer_t *layer, int sx, int sy, const char *icao) {
    lv_draw_line_dsc_t line;
    lv_draw_line_dsc_init(&line);
    line.color = COLOR_AIRPORT_GLYPH;
    line.width = 1;
    line.opa = LV_OPA_70;

    line.p1 = {(lv_value_precise_t)(sx - GLYPH_R), (lv_value_precise_t)sy};
    line.p2 = {(lv_value_precise_t)(sx + GLYPH_R), (lv_value_precise_t)sy};
    lv_draw_line(layer, &line);
    line.p1 = {(lv_value_precise_t)sx, (lv_value_precise_t)(sy - GLYPH_R)};
    line.p2 = {(lv_value_precise_t)sx, (lv_value_precise_t)(sy + GLYPH_R)};
    lv_draw_line(layer, &line);

    lv_draw_label_dsc_t lbl;
    lv_draw_label_dsc_init(&lbl);
    lbl.color = COLOR_AIRPORT_GLYPH;
    lbl.font = &lv_font_montserrat_14;
    lbl.opa = LV_OPA_80;
    lbl.text = icao;
    lv_area_t area = {(lv_coord_t)(sx + GLYPH_R + 2), (lv_coord_t)(sy - 8),
                       (lv_coord_t)(sx + GLYPH_R + 60), (lv_coord_t)(sy + 8)};
    lv_draw_label(layer, &lbl, &area);
}

// Draws every *saved* airport currently on screen. Only the currently
// active/selected location gets full runway geometry — other saved airports
// that happen to be in view are shown as a plain glyph, otherwise a KDEN-vs-
// KAPA situation draws two full runway diagrams at once and it's not obvious
// which one is actually "here". Airports you haven't saved are handled
// separately by draw_static_airport_glyphs().
static void draw_saved_airports(lv_layer_t *layer) {
    // static, not stack-local: this runs inside LVGL's render/draw callback
    // chain on loopTask (~8KB stack) — a ~3.75KB struct as a stack variable
    // there caused a deterministic "Stack protection fault" on every boot.
    static LabelRectSet placed;
    placed.count = 0; // reset each frame; .rects entries beyond count are never read
    float radius_nm = range_get_nm();
    int active = locations_active_index();
    int n = locations_count();
    for (int i = 0; i < n; i++) {
        const Location *loc = locations_get(i);
        if (!loc) continue;
        int sx, sy;
        if (!_proj.to_screen(loc->lat, loc->lon, sx, sy)) continue;

        if (loc->runway_count > 0 && i == active) {
            draw_runways_for(layer, loc, placed, radius_nm);
        } else {
            draw_airport_glyph(layer, sx, sy, loc->icao);
        }
    }
}

#if HAS_AIRPORTS_DB
static bool is_saved_icao(const char *icao) {
    int n = locations_count();
    for (int i = 0; i < n; i++) {
        const Location *loc = locations_get(i);
        if (loc && strcmp(loc->icao, icao) == 0) return true;
    }
    return false;
}

// Passive "there's an airport here" markers from the static compiled-in DB
// (large/medium airports worldwide — see tools/generate_airports_db.py).
// Anything already drawn with runways by draw_saved_airports() is skipped
// here to avoid a double marker.
static void draw_static_airport_glyphs(lv_layer_t *layer) {
    // Medium airports used to be suppressed above 25nm to avoid cluttering
    // wide views, but that meant real nearby fields (e.g. KBJC/KBKF around
    // KDEN, KTEB/KFRG/KMMU around KJFK) were invisible at 50nm even though
    // they were on screen. Show large+medium at any zoom now.
    for (int i = 0; i < AIRPORTS_DB_COUNT; i++) {
        const StaticAirport &ap = airports_db[i];

        int sx, sy;
        if (!_proj.to_screen(ap.lat, ap.lon, sx, sy)) continue;
        if (is_saved_icao(ap.icao)) continue;

        draw_airport_glyph(layer, sx, sy, ap.icao);
    }
}
#endif


static void draw_aircraft(lv_layer_t *layer) {
    if (!_list->lock(pdMS_TO_TICKS(5))) return; // short timeout: skip frame if data locked

    int drawn = 0;
    uint32_t now = millis();
    for (int i = 0; i < _list->count; i++) {
        Aircraft &ac = _list->aircraft[i];
        uint8_t ac_opa = compute_aircraft_opacity(ac.stale_since, now);
        if (ac_opa == 0) continue;
        if (!aircraft_passes_filter(ac)) continue;
        if (g_config.hide_ground && ac.on_ground) continue;

        int sx, sy;
        if (!_proj.to_screen(ac.lat, ac.lon, sx, sy)) continue;
        drawn++;

        // Category color for the aircraft icon
        IconType icon = classify_icon(ac);
        lv_color_t color;
        if (ac.is_emergency)       color = COLOR_EMERGENCY;
        else if (ac.is_military)   color = COLOR_MILITARY;
        else if (icon == ICON_HELI) color = COLOR_HELI_CAT;
        else if (icon == ICON_GA)  color = COLOR_GA_PRIVATE;
        else                       color = COLOR_COMMERCIAL;

        // Draw trail (if enabled in settings) — altitude-colored
        if (ac.trail_count > 1 && g_config.trails_enabled) {
            int max_pts = g_config.trail_max_points;
            int start = (ac.trail_count > max_pts) ? ac.trail_count - max_pts : 0;
            if (start < 1) start = 1;
            lv_draw_line_dsc_t trail_dsc;
            lv_draw_line_dsc_init(&trail_dsc);
            trail_dsc.width = 1;

            for (int t = start; t < ac.trail_count; t++) {
                int tx1, ty1, tx2, ty2;
                if (_proj.to_screen(ac.trail[t - 1].lat, ac.trail[t - 1].lon, tx1, ty1) &&
                    _proj.to_screen(ac.trail[t].lat, ac.trail[t].lon, tx2, ty2)) {
                    trail_dsc.color = altitude_color(ac.trail[t].alt);
                    trail_dsc.opa = LV_OPA_50 + (t * LV_OPA_50 / ac.trail_count);
                    trail_dsc.p1 = {(lv_value_precise_t)tx1, (lv_value_precise_t)ty1};
                    trail_dsc.p2 = {(lv_value_precise_t)tx2, (lv_value_precise_t)ty2};
                    lv_draw_line(layer, &trail_dsc);
                }
            }
        }

        // Draw aircraft icon rotated to heading
        float heading_rad = ac.heading * M_PI / 180.0f;
        float sin_h = sinf(heading_rad);
        float cos_h = cosf(heading_rad);

        switch (icon) {
            case ICON_AIRLINER: draw_icon_airliner(layer, sx, sy, sin_h, cos_h, color, ac_opa); break;
            case ICON_JET:      draw_icon_jet(layer, sx, sy, sin_h, cos_h, color, ac_opa); break;
            case ICON_GA:       draw_icon_ga(layer, sx, sy, sin_h, cos_h, color, ac_opa); break;
            case ICON_HELI:     draw_icon_heli(layer, sx, sy, sin_h, cos_h, color, ac_opa); break;
        }

        // Bold red tracking circle around focused aircraft
        if (_tracked_hex[0] && strcmp(ac.icao_hex, _tracked_hex) == 0) {
            lv_draw_arc_dsc_t ring;
            lv_draw_arc_dsc_init(&ring);
            ring.color = lv_color_hex(0xff2222);
            ring.width = 3;
            ring.start_angle = 0;
            ring.end_angle = 360;
            ring.center.x = sx;
            ring.center.y = sy;
            ring.radius = 22;
            ring.opa = LV_OPA_COVER;
            lv_draw_arc(layer, &ring);
        }

        // Draw callsign label
        const char *label_text = ac.callsign[0] ? ac.callsign : ac.icao_hex;
        lv_draw_label_dsc_t lbl_dsc;
        lv_draw_label_dsc_init(&lbl_dsc);
        lbl_dsc.color = color;
        lbl_dsc.font = &lv_font_montserrat_14;
        lbl_dsc.opa = (uint8_t)((ac_opa * LV_OPA_80) / 255);
        lv_area_t lbl_area = {(lv_coord_t)(sx + 12), (lv_coord_t)(sy - 7),
                               (lv_coord_t)(sx + 130), (lv_coord_t)(sy + 10)};
        lbl_dsc.text = label_text;
        lv_draw_label(layer, &lbl_dsc, &lbl_area);
    }

    _drawn_count = drawn;
    _list->unlock();
}

static void draw_altitude_legend(lv_layer_t *layer) {
    struct { const char *label; lv_color_t color; } entries[] = {
        {"GND",  lv_color_hex(0x666666)},
        {"<5k",  lv_color_hex(0x00cc44)},
        {"<15k", lv_color_hex(0x88cc00)},
        {"<25k", lv_color_hex(0xcccc00)},
        {"<35k", lv_color_hex(0xcc8800)},
        {"35k+", lv_color_hex(0xcc2200)},
    };

    int x = 8;
    int y = CANVAS_H - 18;

    for (int i = 0; i < 6; i++) {
        lv_draw_rect_dsc_t swatch;
        lv_draw_rect_dsc_init(&swatch);
        swatch.bg_color = entries[i].color;
        swatch.bg_opa = LV_OPA_COVER;
        swatch.radius = 2;
        lv_area_t sa = {(lv_coord_t)x, (lv_coord_t)y,
                        (lv_coord_t)(x + 8), (lv_coord_t)(y + 8)};
        lv_draw_rect(layer, &swatch, &sa);

        lv_draw_label_dsc_t lbl;
        lv_draw_label_dsc_init(&lbl);
        lbl.color = entries[i].color;
        lbl.font = &lv_font_montserrat_14;
        lbl.opa = LV_OPA_80;
        lbl.text = entries[i].label;
        lv_area_t la = {(lv_coord_t)(x + 12), (lv_coord_t)(y - 2),
                        (lv_coord_t)(x + 60), (lv_coord_t)(y + 12)};
        lv_draw_label(layer, &lbl, &la);

        x += 58;
    }
}

// Draw icon type legend above altitude legend — uses category colors
static void draw_icon_legend(lv_layer_t *layer) {
    int y = CANVAS_H - 38;

    struct { const char *label; IconType type; lv_color_t color; } entries[] = {
        {"AIR",  ICON_AIRLINER, COLOR_COMMERCIAL},
        {"GA",   ICON_GA,       COLOR_GA_PRIVATE},
        {"MIL",  ICON_JET,      COLOR_MILITARY},
        {"HELI", ICON_HELI,     COLOR_HELI_CAT},
    };

    int x = 8;
    for (int i = 0; i < 4; i++) {
        switch (entries[i].type) {
            case ICON_AIRLINER: draw_icon_airliner(layer, x + 6, y + 6, 0, 1, entries[i].color, LV_OPA_80); break;
            case ICON_JET:      draw_icon_jet(layer, x + 6, y + 6, 0, 1, entries[i].color, LV_OPA_80); break;
            case ICON_GA:       draw_icon_ga(layer, x + 6, y + 6, 0, 1, entries[i].color, LV_OPA_80); break;
            case ICON_HELI:     draw_icon_heli(layer, x + 6, y + 6, 0, 1, entries[i].color, LV_OPA_80); break;
        }

        lv_draw_label_dsc_t lbl;
        lv_draw_label_dsc_init(&lbl);
        lbl.color = entries[i].color;
        lbl.font = &lv_font_montserrat_14;
        lbl.opa = LV_OPA_80;
        lbl.text = entries[i].label;
        lv_area_t la = {(lv_coord_t)(x + 16), (lv_coord_t)(y - 1),
                        (lv_coord_t)(x + 60), (lv_coord_t)(y + 14)};
        lv_draw_label(layer, &lbl, &la);

        x += 58;
    }
}

// Draw active filter indicator on canvas
static void draw_filter_label(lv_layer_t *layer) {
    char buf[96];
    lv_color_t color;
    if (filter_label_text(buf, sizeof(buf), &color) == 0) return;

    lv_draw_label_dsc_t lbl;
    lv_draw_label_dsc_init(&lbl);
    lbl.color = color;
    lbl.font = &lv_font_montserrat_14;
    lbl.opa = LV_OPA_COVER;
    lbl.text = buf;
    lv_area_t la = {(lv_coord_t)8, (lv_coord_t)4,
                    (lv_coord_t)300, (lv_coord_t)20};
    lv_draw_label(layer, &lbl, &la);
}

#if HAS_STATIC_MAP
static lv_image_dsc_t _static_map_dscs[STATIC_MAP_COUNT];
static bool _static_maps_inited = false;

static void init_static_maps() {
    for (int i = 0; i < STATIC_MAP_COUNT; i++) {
        memset(&_static_map_dscs[i], 0, sizeof(lv_image_dsc_t));
        _static_map_dscs[i].header.cf = LV_COLOR_FORMAT_RGB565;
        _static_map_dscs[i].header.w = STATIC_MAP_W;
        _static_map_dscs[i].header.h = STATIC_MAP_H;
        _static_map_dscs[i].header.stride = STATIC_MAP_STRIDE;
        _static_map_dscs[i].data_size = static_maps[i].data_size;
        _static_map_dscs[i].data = static_maps[i].data;
    }
    _static_maps_inited = true;
}

static void draw_static_background(lv_layer_t *layer) {
    if (!_static_maps_inited) init_static_maps();

    // Find matching zoom level
    int radius = (int)_proj.radius_nm;
    int idx = -1;
    for (int i = 0; i < STATIC_MAP_COUNT; i++) {
        if (static_maps[i].radius_nm == radius) { idx = i; break; }
    }
    if (idx < 0) return;

    lv_draw_image_dsc_t img_dsc;
    lv_draw_image_dsc_init(&img_dsc);
    img_dsc.src = &_static_map_dscs[idx];
    img_dsc.opa = LV_OPA_COVER;
    // Scale from STATIC_MAP_W×H to full canvas (256 = 1x)
    img_dsc.scale_x = (CANVAS_W * 256) / STATIC_MAP_W;
    img_dsc.scale_y = (CANVAS_H * 256) / STATIC_MAP_H;
    img_dsc.pivot.x = 0;
    img_dsc.pivot.y = 0;
    lv_area_t area = {0, 0, (lv_coord_t)(CANVAS_W - 1), (lv_coord_t)(CANVAS_H - 1)};
    lv_draw_image(layer, &img_dsc, &area);
}
#endif

// Re-centers on and re-lists whatever location is currently active, if it
// changed since the last check. Cheap to call often.
static void sync_active_location() {
    int active = locations_active_index();
    if (active == _last_active_loc) return;
    _last_active_loc = active;

    float lat, lon;
    int elev;
    if (locations_get_active_coords(&lat, &lon, &elev)) {
        _proj.center_lat = lat;
        _proj.center_lon = lon;
    }
    _list = locations_active_list(_home_list);
    if (_canvas) lv_obj_invalidate(_canvas);
}

static void canvas_draw_cb(lv_event_t *e) {
    lv_layer_t *layer = lv_event_get_layer(e);

#if HAS_STATIC_MAP
    draw_static_background(layer);
#endif
    draw_range_rings(layer);
    draw_home_marker(layer);
#if HAS_AIRPORTS_DB
    draw_static_airport_glyphs(layer);
#endif
    draw_saved_airports(layer);
    draw_aircraft(layer);
    draw_icon_legend(layer);
    draw_altitude_legend(layer);
    draw_filter_label(layer);
}

void map_view_init(lv_obj_t *parent, AircraftList *list) {
    _list = list;
    _home_list = list;

    _proj.center_lat = g_config.home_lat;
    _proj.center_lon = g_config.home_lon;
    _proj.radius_nm = range_get_nm();
    _proj.screen_w = CANVAS_W;
    _proj.screen_h = CANVAS_H;
    _proj.offset_x = 0;
    _proj.offset_y = 0;

    _canvas = lv_obj_create(parent);
    lv_obj_set_size(_canvas, CANVAS_W, CANVAS_H);
    lv_obj_set_pos(_canvas, 0, 0);
    lv_obj_set_style_bg_color(_canvas, BG_COLOR, 0);
    lv_obj_set_style_bg_opa(_canvas, LV_OPA_COVER, 0);
    lv_obj_set_style_border_width(_canvas, 0, 0);
    lv_obj_set_style_radius(_canvas, 0, 0);
    lv_obj_set_style_pad_all(_canvas, 0, 0);
    lv_obj_clear_flag(_canvas, LV_OBJ_FLAG_SCROLLABLE);
    lv_obj_clear_flag(_canvas, LV_OBJ_FLAG_SCROLL_CHAIN);
    views_attach_swipe(_canvas);

    lv_obj_add_event_cb(_canvas, canvas_draw_cb, LV_EVENT_DRAW_MAIN_END, nullptr);

    // Tap: aircraft hit-test -> detail card
    lv_obj_add_event_cb(_canvas, [](lv_event_t *e) {
        if (views_get_active_index() != VIEW_MAP) return;
        if (views_swipe_active()) { views_clear_swipe(); return; }

        // Guard: skip if a filter button was just clicked
        if (_filter_just_clicked) {
            _filter_just_clicked = false;
            return;
        }

        lv_point_t point;
        lv_indev_get_point(lv_indev_active(), &point);

        int tx = point.x;
        int ty = point.y - 30;

        if (detail_card_is_visible()) {
            detail_card_hide();
            // Keep _tracked_hex — circle stays after closing detail card
            return;
        }

        // Hit test against aircraft (30px hit radius) -- same filter/hide_ground
        // gating as draw_aircraft(), so a hidden aircraft can't be tapped.
        if (!_list->lock(pdMS_TO_TICKS(10))) return;
        for (int i = 0; i < _list->count; i++) {
            if (!aircraft_passes_filter(_list->aircraft[i])) continue;
            if (g_config.hide_ground && _list->aircraft[i].on_ground) continue;
            int sx, sy;
            if (_proj.to_screen(_list->aircraft[i].lat, _list->aircraft[i].lon, sx, sy)) {
                int dx = tx - sx;
                int dy = ty - sy;
                if (dx * dx + dy * dy < 900) {
                    Aircraft ac_copy = _list->aircraft[i];
                    strlcpy(_tracked_hex, ac_copy.icao_hex, sizeof(_tracked_hex));
                    _list->unlock();
                    detail_card_show(&ac_copy);
                    return;
                }
            }
        }
        _list->unlock();
        // Tapped empty space — clear tracking
        _tracked_hex[0] = '\0';
    }, LV_EVENT_CLICKED, nullptr);

    // Filter toggle buttons — vertical stack on right edge
    int btn_w = 64;
    int btn_h = 48;
    int btn_gap = 10;
    int total_h = NUM_FILTERS * btn_h + (NUM_FILTERS - 1) * btn_gap;
    int btn_x = CANVAS_W - btn_w - 8;
    int btn_y0 = (CANVAS_H - total_h) / 2;
    for (int i = 0; i < NUM_FILTERS; i++) {
        lv_obj_t *btn = lv_obj_create(parent);
        lv_obj_set_size(btn, btn_w, btn_h);
        lv_obj_set_pos(btn, btn_x, btn_y0 + i * (btn_h + btn_gap));
        lv_obj_set_style_bg_color(btn, lv_color_hex(0x0a0a1a), 0);
        lv_obj_set_style_bg_opa(btn, LV_OPA_70, 0);
        lv_obj_set_style_border_color(btn, filter_defs[i].color, 0);
        lv_obj_set_style_border_width(btn, 1, 0);
        lv_obj_set_style_border_opa(btn, LV_OPA_40, 0);
        lv_obj_set_style_radius(btn, 6, 0);
        lv_obj_set_style_pad_all(btn, 0, 0);
        lv_obj_clear_flag(btn, LV_OBJ_FLAG_SCROLLABLE);
        lv_obj_clear_flag(btn, LV_OBJ_FLAG_SCROLL_CHAIN);
        lv_obj_add_event_cb(btn, filter_click_cb, LV_EVENT_CLICKED,
                            (void *)(intptr_t)i);

        lv_obj_t *lbl = lv_label_create(btn);
        lv_label_set_text(lbl, filter_defs[i].label);
        lv_obj_set_style_text_font(lbl, &lv_font_montserrat_16, 0);
        lv_obj_set_style_text_color(lbl, lv_color_hex(0x666666), 0);
        lv_obj_center(lbl);

        _filter_btns[i] = btn;
        _filter_lbls[i] = lbl;
    }

    // Range label — bottom-right, tappable
    _range_label = lv_label_create(parent);
    lv_label_set_text(_range_label, range_label());
    lv_obj_set_style_text_font(_range_label, &lv_font_montserrat_20, 0);
    lv_obj_set_style_text_color(_range_label, lv_color_hex(0x4488ff), 0);
    lv_obj_set_pos(_range_label, CANVAS_W - 80, CANVAS_H - 28);
    lv_obj_add_flag(_range_label, LV_OBJ_FLAG_CLICKABLE);
    lv_obj_clear_flag(_range_label, LV_OBJ_FLAG_SCROLL_CHAIN);
    lv_obj_add_event_cb(_range_label, [](lv_event_t *e) {
        range_cycle();
        lv_label_set_text(_range_label, range_label());
        _proj.radius_nm = range_get_nm();
        lv_obj_invalidate(_canvas);
    }, LV_EVENT_CLICKED, nullptr);

    // Loading overlay — shown until first aircraft data arrives
    overlay_create(parent);

    // Periodic refresh — skip when touch active to prioritize gestures
    static unsigned _last_synced_filter = ~0u; // impossible bitmask value, forces sync on first tick
    static float _last_range = -1;
    lv_timer_create([](lv_timer_t *t) {
        // Sync filter button visuals if filter changed from another view
        unsigned af = filter_get_active();
        if (af != _last_synced_filter) {
            _last_synced_filter = af;
            update_filter_visuals();
        }

        // Update loading overlay
        overlay_update();

        // Skip rendering when touch is active
        if (touch_active) return;

        if (views_get_active_index() == VIEW_MAP) {
            float r = range_get_nm();
            if (r != _last_range) {
                _last_range = r;
                _proj.radius_nm = r;
                lv_label_set_text(_range_label, range_label());
            }
            sync_active_location();
            lv_obj_invalidate(_canvas);
        }
    }, 1000, nullptr);
}

void map_view_update() {
    if (_canvas) lv_obj_invalidate(_canvas);
}

void map_view_on_show() {
    float r = range_get_nm();
    if (r != _proj.radius_nm) {
        _proj.radius_nm = r;
        if (_range_label) lv_label_set_text(_range_label, range_label());
    }
    sync_active_location();
    if (_canvas) lv_obj_invalidate(_canvas);
}

void map_view_center_on(float lat, float lon) {
    _proj.center_lat = lat;
    _proj.center_lon = lon;
    if (_canvas) lv_obj_invalidate(_canvas);
}

int map_view_drawn_count() {
    return _drawn_count;
}

void map_view_track(const char *icao_hex) {
    if (icao_hex && icao_hex[0])
        strlcpy(_tracked_hex, icao_hex, sizeof(_tracked_hex));
    else
        _tracked_hex[0] = '\0';
}
