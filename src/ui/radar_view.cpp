#include "../platform/platform.h" // millis()/strlcpy compatibility shims on non-Arduino builds
#include "radar_view.h"
#include "views.h"
#include "status_bar.h"
#include "detail_card.h"
#include "filters.h"
#include "aircraft_icons.h" // legend now matches map's icon shapes -- see draw_radar_icon_legend()
#include "display_prefs.h"
#include "../pins_config.h"
#include "../data/storage.h"
#include "../data/locations.h"
#include "geo.h"
#include "range.h"
#include <cstring>
#include <cstdio> // snprintf -- not reliably transitive under libstdc++ (Pi build)

// Static large/medium airport glyph DB (generated by tools/generate_airports_db.py)
// -- same optional include as map_view.cpp.
#if __has_include("airports_db.h")
#include "airports_db.h"
#define HAS_AIRPORTS_DB 1
#elif __has_include("ui/airports_db.h")
#include "ui/airports_db.h"
#define HAS_AIRPORTS_DB 1
#else
#define HAS_AIRPORTS_DB 0
#endif

static AircraftList *_list = nullptr;      // the one aircraft list -- fetch_task always fetches for whichever location is currently active
static int _last_active_loc = -2;          // sentinel so the first tick always syncs (-1 is a valid "nothing selected")
static lv_obj_t *_radar_obj = nullptr;

static float _sweep_angle = 0.0f; // current sweep angle in degrees
static uint32_t _last_sweep_ms = 0;
// Per-view "clear trails" cutoff -- Map and Radar share the same underlying
// Aircraft/TrailPoint data, so clearing trails must not mutate that shared
// data (it would clear both views at once). Instead each view independently
// stops drawing any trail point older than its own cutoff.
static uint32_t _trails_cleared_at = 0;

#if !defined(ARDUINO)
// Temporary per-phase profiling -- two rounds of pure draw-count cuts to
// the sweep still reported jumpy, and the resulting numbers (sweep
// avg=550-750ms vs. rings' steady ~27ms and blips' ~0-1ms *despite*
// blips issuing far more draw calls at ~79 aircraft) don't fit a simple
// "N draws x fixed per-call cost" model -- something about many
// lv_draw_line calls all radiating from the same center point (heavily
// overlapping bounding boxes near the origin) is disproportionately
// expensive versus blips' well-separated, non-overlapping dots. Split
// draw_sweep() itself into "trail" vs "bloom+hub" sub-phases to find out
// which part of *that* is the real villain, instead of guessing again.
// Logs avg/max per phase every ~2s of wall time (not every frame, would
// flood journalctl) to stdout/journalctl -u flightlevel314. Delete this whole
// #if block (and every profile_record()/profile_maybe_log() call site)
// once the actual bottleneck is identified and fixed -- same "temporary,
// clearly marked, removed once its job is done" pattern as the earlier
// debug ruler.
struct RadarProfilePhase {
    const char *name;
    uint32_t sum_ms = 0, max_ms = 0, count = 0;
};
static RadarProfilePhase _prof_rings{"rings"}, _prof_trail{"sweep.trail"},
    _prof_bloom_hub{"sweep.bloomhub"}, _prof_blips{"blips"},
    _prof_legend{"legend"}, _prof_total{"TOTAL"};
static uint32_t _prof_last_log_ms = 0;

static void profile_record(RadarProfilePhase &p, uint32_t dt) {
    p.sum_ms += dt;
    if (dt > p.max_ms) p.max_ms = dt;
    p.count++;
}

static void profile_maybe_log() {
    uint32_t now = millis();
    if (now - _prof_last_log_ms < 2000) return;
    _prof_last_log_ms = now;
    RadarProfilePhase *phases[] = {&_prof_rings, &_prof_trail, &_prof_bloom_hub,
                                    &_prof_blips, &_prof_legend, &_prof_total};
    platform_log("[RadarProfile] ");
    for (RadarProfilePhase *p : phases) {
        uint32_t avg = p->count ? p->sum_ms / p->count : 0;
        platform_log("%s avg=%ums max=%ums (n=%u) ", p->name, avg, p->max_ms, p->count);
        p->sum_ms = 0; p->max_ms = 0; p->count = 0;
    }
    platform_log("\n");
}
#endif

#define RADAR_W LCD_H_RES
#define RADAR_H (LCD_V_RES - STATUS_BAR_HEIGHT)
#define RADAR_CX (RADAR_W / 2)
// RADAR_H is the canvas *object's* declared height (matches its tile) --
// kept as-is for the object's own size and the filter-button column, which
// are real LVGL layout needing the tile's actual bounds. RADAR_CY/RADAR_R
// below are *measured* fixed values instead (see project backlog:
// "bullseye/legend centering" -- a ruler overlay + a photo of the running
// hardware, not another guess). Same fixed center/radius as
// map_view.cpp's MAP_BULLSEYE_CY/R (see that file's comment for the full
// jc1060 + Pi measurement history) so both screens actually match --
// previously each computed its own slightly different position from
// separate margin math.
//
// Note this affects aircraft position too, not just the compass --
// to_radar_screen() (used for both) derives its scale from RADAR_R/RADAR_CY
// directly, unlike map_view.cpp where the rings and _proj.screen_h are
// separate.
#if LCD_V_RES == 800
#define RADAR_CY 420
#define RADAR_R  342
#else
#define RADAR_CY 310
#define RADAR_R  251
#endif

#define SWEEP_PERIOD_MS 30000  // one full rotation = 30 seconds

#define COLOR_SWEEP lv_color_hex(0x00ff44)
#define COLOR_RING lv_color_hex(0x0a2a0a)
#define COLOR_TEXT lv_color_hex(0x00cc33)
#define COLOR_BG lv_color_hex(0x000800)

#if !defined(ARDUINO)
// Pi-exclusive CRT phosphor fade: blip/label/trail opacity tracks how far
// the sweep arm has gone past this bearing. Full bright at paint, eases
// down to near-invisible over nearly a full rotation, then snaps bright
// again when the arm comes back. Aircraft positions still update from
// ADS-B every fetch -- only drawn alpha follows the sweep. jc1060 keeps
// the short "boost then stay bright" curve below (draw-budget / look).
#define PHOSPHOR_BRIGHT_DEG  15.0f    // brief full-bright flash at paint
#define PHOSPHOR_FADE_DEG   350.0f    // nearly full circle before floor
#define PHOSPHOR_MIN_OPA    ((lv_opa_t)38)  // ~15% — almost invisible before repaint
#define PAINT_DETAIL_DEG    45.0f     // expanded tag stack right after paint
#define PHOSPHOR_LABEL_MIN  LV_OPA_20 // hide tags once phosphor is this dim
#else
#define SWEEP_BRIGHT_DEG 60.0f        // full brightness boost zone
#define SWEEP_FADE_DEG   180.0f       // fade boost back to normal
#define BLIP_NORMAL_OPA  LV_OPA_90    // normal blip brightness
#define PAINT_DETAIL_DEG 45.0f        // expanded detail zone right after sweep
#define LABEL_VISIBLE_DEG 240.0f      // callsign label visibility zone
#endif

static MapProjection _proj;

// Per-view filter button/label pointers
static lv_obj_t *_filter_btns[NUM_FILTERS] = {};
static lv_obj_t *_filter_lbls[NUM_FILTERS] = {};
// GND is a quick-access toggle for g_config.view_hide_ground[VIEW_RADAR] -- not part of the
// FILT_* bitmask (unconditional exclude, not an OR/AND-able category or
// state match), but drawn in the same button stack, state group with VERT.
static lv_obj_t *_gnd_btn = nullptr;
static lv_obj_t *_gnd_lbl = nullptr;
static bool _filter_just_clicked = false;

// Convert lat/lon to radar-relative screen coords
static bool to_radar_screen(float lat, float lon, int &sx, int &sy) {
    float dx_nm = (lon - _proj.center_lon) * 60.0f * cosf(_proj.center_lat * M_PI / 180.0f);
    float dy_nm = (lat - _proj.center_lat) * 60.0f;
    float dist_nm = sqrtf(dx_nm * dx_nm + dy_nm * dy_nm);

    if (dist_nm > _proj.radius_nm) return false;

    float scale = (float)RADAR_R / _proj.radius_nm;
    sx = RADAR_CX + (int)(dx_nm * scale);
    sy = RADAR_CY - (int)(dy_nm * scale);
    return true;
}

// Get bearing angle (0=N, 90=E) from radar center to a screen point
static float blip_angle(int sx, int sy) {
    float dx = (float)(sx - RADAR_CX);
    float dy = (float)(RADAR_CY - sy); // invert Y (screen Y goes down)
    float angle = atan2f(dx, dy) * 180.0f / M_PI;
    if (angle < 0) angle += 360.0f;
    return angle;
}

// Angular distance from sweep to blip (how far behind the sweep the blip is)
static float angle_behind_sweep(float blip_deg) {
    float diff = _sweep_angle - blip_deg;
    if (diff < 0) diff += 360.0f;
    return diff; // 0 = just swept, 359 = about to be swept
}

static void draw_rings(lv_layer_t *layer) {
    lv_draw_arc_dsc_t arc;
    lv_draw_arc_dsc_init(&arc);
    arc.color = COLOR_RING;
    arc.width = 1;
    arc.start_angle = 0;
    arc.end_angle = 360;
    arc.center.x = RADAR_CX;
    arc.center.y = RADAR_CY;

    float range = range_get_nm();
    float ring_nm;
    if (range >= 100) ring_nm = 25.0f;
    else if (range >= 50) ring_nm = 10.0f;
    else if (range >= 20) ring_nm = 5.0f;
    else ring_nm = 1.0f;

    float scale = (float)RADAR_R / range;
    for (float r = ring_nm; r <= range; r += ring_nm) {
        arc.radius = (int)(r * scale);
        arc.center.x = RADAR_CX;
        arc.center.y = RADAR_CY;
        lv_draw_arc(layer, &arc);
    }

    // Cardinal direction labels
    const char *dirs[] = {"N", "E", "S", "W"};
    int dx[] = {0, 1, 0, -1};
    int dy[] = {-1, 0, 1, 0};
    lv_draw_label_dsc_t lbl;
    lv_draw_label_dsc_init(&lbl);
    lbl.color = COLOR_RING;
    lbl.font = &lv_font_montserrat_14;
    for (int i = 0; i < 4; i++) {
        int lx = RADAR_CX + dx[i] * (RADAR_R + 2) - 5;
        int ly = RADAR_CY + dy[i] * (RADAR_R + 2) - 7;
        lv_area_t area = {(lv_coord_t)lx, (lv_coord_t)ly,
                          (lv_coord_t)(lx + 20), (lv_coord_t)(ly + 16)};
        lbl.text = dirs[i];
        lbl.text_static = 1; // string literal; safe without text_local
        lv_draw_label(layer, &lbl, &area);
    }

    // Cross lines
    lv_draw_line_dsc_t line;
    lv_draw_line_dsc_init(&line);
    line.color = COLOR_RING;
    line.width = 1;
    line.opa = LV_OPA_30;
    line.p1 = {RADAR_CX, RADAR_CY - RADAR_R};
    line.p2 = {RADAR_CX, RADAR_CY + RADAR_R};
    lv_draw_line(layer, &line);
    line.p1 = {RADAR_CX - RADAR_R, RADAR_CY};
    line.p2 = {RADAR_CX + RADAR_R, RADAR_CY};
    lv_draw_line(layer, &line);
}

#if !defined(ARDUINO)
// Pi-exclusive richer sweep -- jc1060's 6-line banded fade (kept verbatim
// below) was sized for the P4's weaker GPU/heap budget. Real profiling
// on the Pi (journalctl, three rounds) found the actual constraint:
// sweep.trail (120 lines) cost 530-726ms, sweep.bloomhub (6 draws: 3
// bloom lines + 3 hub circles) cost 7-24ms -- dividing out, both land on
// the same ~4.5-6ms *per single lv_draw_* call*, uniformly, on this
// hardware's DRM rendering path (rings' steady ~27ms for ~10-12 draws
// matches too). Not an "overlapping lines near one point" penalty as
// first suspected -- just a much higher flat per-draw-call cost than
// expected from any software rasterizer, and it applies to every draw
// call, not something specific to this effect. Budget: rings alone
// already costs ~27ms of the ~100ms/frame target (10fps), so the sweep
// needs to stay under roughly 10-12 total draw calls to add well under
// 50ms. Landed on 8 trail segments (up from jc1060's 6, close to the
// same 3deg/segment angular density, but with a smooth eased quadratic
// falloff instead of jc1060's linear per-band steps -- same draw count,
// better-looking curve, zero extra cost) plus a 2-line bloom (down from
// 3) and no hub glow (dropped entirely) -- 10 total draws vs. jc1060's
// 7, comfortably inside budget instead of the 130 tried initially.
static void draw_sweep(lv_layer_t *layer) {
    float rad = _sweep_angle * M_PI / 180.0f;
    int ex = RADAR_CX + (int)(RADAR_R * sinf(rad));
    int ey = RADAR_CY - (int)(RADAR_R * cosf(rad));

    lv_draw_line_dsc_t line;
    lv_draw_line_dsc_init(&line);
    line.color = COLOR_SWEEP;

    // Comet tail: same angular density as jc1060 (3deg/segment), just an
    // eased (squared) opacity falloff instead of discrete linear steps.
    const float TAIL_DEG = 24.0f;
    const int TAIL_SEGMENTS = 8;
    uint32_t t0 = millis();
    for (int i = TAIL_SEGMENTS; i >= 1; i--) {
        float t = (float)i / TAIL_SEGMENTS;   // 1.0 (far) .. ~0 (near sweep)
        float trail_rad = (_sweep_angle - t * TAIL_DEG) * M_PI / 180.0f;
        int tx = RADAR_CX + (int)(RADAR_R * sinf(trail_rad));
        int ty = RADAR_CY - (int)(RADAR_R * cosf(trail_rad));
        float fade = (1.0f - t) * (1.0f - t);
        line.opa = (lv_opa_t)(fade * LV_OPA_50);
        line.width = 1;
        line.p1 = {RADAR_CX, RADAR_CY};
        line.p2 = {(lv_value_precise_t)tx, (lv_value_precise_t)ty};
        lv_draw_line(layer, &line);
    }
    uint32_t t1 = millis();
    profile_record(_prof_trail, t1 - t0);

    // Bloomed leading edge -- wide/dim under narrow/bright, 2 draws
    // instead of the original 3 (dropped the widest/dimmest one).
    line.p1 = {RADAR_CX, RADAR_CY};
    line.p2 = {(lv_value_precise_t)ex, (lv_value_precise_t)ey};
    line.opa = LV_OPA_30; line.width = 4; lv_draw_line(layer, &line);
    line.opa = LV_OPA_COVER; line.width = 2; lv_draw_line(layer, &line);
    profile_record(_prof_bloom_hub, millis() - t1);
}
#else
static void draw_sweep(lv_layer_t *layer) {
    float rad = _sweep_angle * M_PI / 180.0f;
    int ex = RADAR_CX + (int)(RADAR_R * sinf(rad));
    int ey = RADAR_CY - (int)(RADAR_R * cosf(rad));

    // Sweep line
    lv_draw_line_dsc_t line;
    lv_draw_line_dsc_init(&line);
    line.color = COLOR_SWEEP;
    line.width = 2;
    line.opa = LV_OPA_60;
    line.p1 = {RADAR_CX, RADAR_CY};
    line.p2 = {(lv_value_precise_t)ex, (lv_value_precise_t)ey};
    lv_draw_line(layer, &line);

    // Fading trail (draw 6 faded lines behind sweep)
    for (int i = 1; i <= 6; i++) {
        float trail_rad = (_sweep_angle - i * 3.0f) * M_PI / 180.0f;
        int tx = RADAR_CX + (int)(RADAR_R * sinf(trail_rad));
        int ty = RADAR_CY - (int)(RADAR_R * cosf(trail_rad));
        line.opa = LV_OPA_40 - i * 6;
        line.width = 1;
        line.p1 = {RADAR_CX, RADAR_CY};
        line.p2 = {(lv_value_precise_t)tx, (lv_value_precise_t)ty};
        lv_draw_line(layer, &line);
    }
}
#endif

static void draw_blips(lv_layer_t *layer) {
    if (!_list->lock(pdMS_TO_TICKS(5))) return; // short timeout: skip frame if data locked

    uint32_t now = millis();

    for (int i = 0; i < _list->count; i++) {
        Aircraft &ac = _list->aircraft[i];
        uint8_t ghost_opa = compute_aircraft_opacity(ac.stale_since, now);
        if (ghost_opa == 0) continue;
        if (!aircraft_passes_filter(ac)) continue;
        if (g_config.view_hide_ground[VIEW_RADAR] && ac.on_ground) continue;

        int sx, sy;
        if (!to_radar_screen(ac.lat, ac.lon, sx, sy)) continue;

        // Sweep-driven opacity. Pi: full-rotation phosphor fade. ESP32:
        // brief boost then stay at BLIP_NORMAL_OPA (see constants above).
        float behind = angle_behind_sweep(blip_angle(sx, sy));
        uint8_t sweep_opa;
#if !defined(ARDUINO)
        if (behind < PHOSPHOR_BRIGHT_DEG) {
            sweep_opa = LV_OPA_COVER;
        } else if (behind < PHOSPHOR_FADE_DEG) {
            float t = (behind - PHOSPHOR_BRIGHT_DEG) /
                      (PHOSPHOR_FADE_DEG - PHOSPHOR_BRIGHT_DEG);
            // Ease-out: linger brighter early, drop faster late -- closer to
            // CRT phosphor than a linear ramp.
            float u = 1.0f - (1.0f - t) * (1.0f - t);
            sweep_opa = (uint8_t)(LV_OPA_COVER -
                (u * (float)(LV_OPA_COVER - PHOSPHOR_MIN_OPA)));
        } else {
            sweep_opa = PHOSPHOR_MIN_OPA;
        }
#else
        if (behind < SWEEP_BRIGHT_DEG) {
            sweep_opa = LV_OPA_COVER;
        } else if (behind < SWEEP_FADE_DEG) {
            float t = (behind - SWEEP_BRIGHT_DEG) / (SWEEP_FADE_DEG - SWEEP_BRIGHT_DEG);
            sweep_opa = LV_OPA_COVER - (uint8_t)(t * (LV_OPA_COVER - BLIP_NORMAL_OPA));
        } else {
            sweep_opa = BLIP_NORMAL_OPA;
        }
#endif

        // Combine sweep brightness with ghost fade (stale aircraft fade out)
        uint8_t opa = (uint8_t)((sweep_opa * ghost_opa) / 255);

        // Category color for blip -- on_ground overrides to gray
        // (altitude_color(0), matching the "GND" legend swatch) same as
        // map_view.cpp; emergency still wins over that.
        lv_color_t color;
        if (ac.is_emergency)  color = COLOR_EMERGENCY;
        else if (ac.on_ground)     color = altitude_color(0);
        else if (ac.is_military)   color = COLOR_MILITARY;
        else if ((ac.category[0] == 'A' && ac.category[1] == '7') ||
                 (ac.type_code[0] && is_heli_type(ac.type_code)))
            color = COLOR_HELI_CAT;
        else if (is_airline_callsign(ac.callsign) ||
                 (ac.category[0] == 'A' && ac.category[1] >= '3'))
            color = COLOR_COMMERCIAL;
        else
            color = COLOR_GA_PRIVATE;

        // Draw trail segments (if enabled) — altitude-colored. Per-view,
        // like Map -- see trails_shown()/trails_amount() (display_prefs.cpp).
        if (ac.trail_count > 1 && trails_shown()) {
            // Scale the effective cap by current zoom -- see the matching
            // comment in map_view.cpp for the full rationale.
            float radius_ratio = range_get_nm() / (float)g_config.radius_presets[3];
            if (radius_ratio > 1.0f) radius_ratio = 1.0f;
            int max_pts = (int)(trails_amount() * radius_ratio);
            if (max_pts < 3) max_pts = 3; // always show some trail, never fully vanish
            int start = (ac.trail_count > max_pts) ? ac.trail_count - max_pts : 0;
            lv_draw_rect_dsc_t tdot;
            lv_draw_rect_dsc_init(&tdot);
            tdot.radius = 1;
            for (int t = start; t < ac.trail_count; t++) {
                if (ac.trail[t].timestamp < _trails_cleared_at) continue;
                int tx, ty;
                if (to_radar_screen(ac.trail[t].lat, ac.trail[t].lon, tx, ty)) {
                    tdot.bg_color = altitude_color(ac.trail[t].alt);
                    uint8_t t_opa = (uint8_t)(LV_OPA_20 + ((t - start) * LV_OPA_40 / (ac.trail_count - start)));
                    tdot.bg_opa = (uint8_t)((t_opa * opa) / 255);
                    lv_area_t ta = {(lv_coord_t)(tx - 1), (lv_coord_t)(ty - 1),
                                    (lv_coord_t)(tx + 1), (lv_coord_t)(ty + 1)};
                    lv_draw_rect(layer, &tdot, &ta);
                }
            }
        }

#if !defined(ARDUINO)
        // Pi-exclusive glowing blip -- one soft halo ring under a bright
        // core dot, instead of jc1060's flat filled square (kept verbatim
        // in the #else below). Real profiling confirmed ~5ms per single
        // lv_draw_* call on this hardware (see draw_sweep()'s comment) --
        // this test run happened to have most tracked aircraft grounded
        // and filtered out of Radar, so a 3-ring version measured cheap
        // by luck, not because it actually is; with real airborne traffic
        // (dozens of aircraft x up to 4 draws each) that per-call cost
        // adds up fast. One ring keeps the per-aircraft cost to 2 draws
        // (vs. jc1060's 1) instead of 4.
        lv_draw_rect_dsc_t glow;
        lv_draw_rect_dsc_init(&glow);
        glow.bg_color = color;
        glow.radius = LV_RADIUS_CIRCLE;
        glow.bg_opa = (uint8_t)((opa * 35) / 100);
        lv_area_t ga = {(lv_coord_t)(sx - 7), (lv_coord_t)(sy - 7),
                        (lv_coord_t)(sx + 7), (lv_coord_t)(sy + 7)};
        lv_draw_rect(layer, &glow, &ga);
        lv_draw_rect_dsc_t dot;
        lv_draw_rect_dsc_init(&dot);
        dot.bg_color = color;
        dot.bg_opa = opa;
        dot.radius = LV_RADIUS_CIRCLE;
        lv_area_t area = {(lv_coord_t)(sx - 3), (lv_coord_t)(sy - 3),
                          (lv_coord_t)(sx + 3), (lv_coord_t)(sy + 3)};
        lv_draw_rect(layer, &dot, &area);
#else
        // Blip dot — larger for better visibility
        lv_draw_rect_dsc_t dot;
        lv_draw_rect_dsc_init(&dot);
        dot.bg_color = color;
        dot.bg_opa = opa;
        dot.radius = 4;
        lv_area_t area = {(lv_coord_t)(sx - 4), (lv_coord_t)(sy - 4),
                          (lv_coord_t)(sx + 4), (lv_coord_t)(sy + 4)};
        lv_draw_rect(layer, &dot, &area);
#endif

        // Labels — two zones: paint detail (0-45deg) and condensed after.
        // Each of Flight ID / Alt-Speed / Type is independently toggled by
        // the status bar's VIEW menu (view_menu.cpp). Flight ID falls back
        // callsign -> registration -> ICAO hex, and never shows registration
        // once a callsign is showing (Type would otherwise redundantly
        // repeat it) -- so there's no separate "registration" line anymore.
#if !defined(ARDUINO)
        // Pi: tags ride the same phosphor curve as the blip; hide once dim.
        if (opa >= PHOSPHOR_LABEL_MIN && (tag_id_shown() || tag_data_shown() || tag_type_shown())) {
            uint8_t lbl_opa = opa;
#else
        if (behind < LABEL_VISIBLE_DEG && (tag_id_shown() || tag_data_shown() || tag_type_shown())) {
            uint8_t lbl_opa = opa > LV_OPA_50 ? LV_OPA_80 : opa;
#endif
            const char *id_text = ac.callsign[0] ? ac.callsign :
                                  (ac.registration[0] ? ac.registration : ac.icao_hex);

#if !defined(ARDUINO)
            // Always use the expanded stack on Pi. Switching to condensed at
            // PAINT_DETAIL_DEG (45deg behind sweep) moves tags from sy-28 to
            // sy-7 while the blip stays put -- reads as labels sliding alone.
            const bool paint_detail = true;
#else
            const bool paint_detail = (behind < PAINT_DETAIL_DEG);
#endif
            if (paint_detail) {
                // === PAINT ZONE: expanded detail -- stack whichever of the
                // 3 fields are on, top to bottom ===
                int line_y = sy - 28;
                // text_local=1: with LV_DRAW_SW_DRAW_UNIT_CNT>1 (Pi pthread
                // SW draw), label tasks run on worker threads after this
                // stack frame / AircraftList unlock returns -- without a
                // copy, stack buffers and ac.* fields are use-after-free
                // and tags render as empty vertical rectangles.
                if (tag_id_shown()) {
                    char line1[48];
                    strlcpy(line1, id_text, sizeof(line1));
                    lv_draw_label_dsc_t l1;
                    lv_draw_label_dsc_init(&l1);
                    l1.color = color;
                    l1.font = &lv_font_montserrat_14;
#if !defined(ARDUINO)
                    l1.opa = lbl_opa;
#else
                    l1.opa = LV_OPA_COVER;
#endif
                    l1.text = line1;
                    l1.text_local = 1;
                    lv_area_t a1 = {(lv_coord_t)(sx + 8), (lv_coord_t)line_y,
                                    (lv_coord_t)(sx + 280), (lv_coord_t)(line_y + 14)};
                    lv_draw_label(layer, &l1, &a1);
                    line_y += 14;
                }

                if (tag_type_shown()) {
                    char line2[48] = {};
                    if (ac.owner_op[0]) strlcpy(line2, ac.owner_op, sizeof(line2));
                    else if (ac.desc[0]) strlcpy(line2, ac.desc, sizeof(line2));
                    else strlcpy(line2, ac.type_code, sizeof(line2));
                    lv_draw_label_dsc_t l2;
                    lv_draw_label_dsc_init(&l2);
                    l2.color = color;
                    l2.font = &lv_font_montserrat_14;
#if !defined(ARDUINO)
                    l2.opa = (uint8_t)((lbl_opa * 3) / 4);
#else
                    l2.opa = (uint8_t)(LV_OPA_COVER * 3 / 4);
#endif
                    l2.text = line2;
                    l2.text_local = 1;
                    lv_area_t a2 = {(lv_coord_t)(sx + 8), (lv_coord_t)line_y,
                                    (lv_coord_t)(sx + 280), (lv_coord_t)(line_y + 14)};
                    lv_draw_label(layer, &l2, &a2);
                    line_y += 14;
                }

                if (tag_data_shown()) {
                    char line3[48];
                    char alt_str[12];
                    if (ac.on_ground) snprintf(alt_str, sizeof(alt_str), "GND");
                    else if (ac.altitude >= 18000) snprintf(alt_str, sizeof(alt_str), "FL%03d", ac.altitude / 100);
                    else snprintf(alt_str, sizeof(alt_str), "%d'", ac.altitude);
                    const char *vr_arrow = ac.vert_rate > 300 ? "^" : ac.vert_rate < -300 ? "v" : "";
                    snprintf(line3, sizeof(line3), "%s %dkt %s", alt_str, ac.speed, vr_arrow);
                    lv_draw_label_dsc_t l3;
                    lv_draw_label_dsc_init(&l3);
                    l3.color = color;
                    l3.font = &lv_font_montserrat_14;
#if !defined(ARDUINO)
                    l3.opa = (uint8_t)((lbl_opa * 2) / 3);
#else
                    l3.opa = (uint8_t)(LV_OPA_COVER * 2 / 3);
#endif
                    l3.text = line3;
                    l3.text_local = 1;
                    lv_area_t a3 = {(lv_coord_t)(sx + 8), (lv_coord_t)line_y,
                                    (lv_coord_t)(sx + 280), (lv_coord_t)(line_y + 14)};
                    lv_draw_label(layer, &l3, &a3);
                }
            } else {
                // === CONDENSED ZONE: Flight ID + Alt/Speed only (Type was
                // never shown here even before this toggle system existed)
                int line_y = sy - 7;
                if (tag_id_shown()) {
                    char top[36];
                    strlcpy(top, id_text, sizeof(top));
                    lv_draw_label_dsc_t lbl;
                    lv_draw_label_dsc_init(&lbl);
                    lbl.color = color;
                    lbl.font = &lv_font_montserrat_14;
                    lbl.opa = lbl_opa;
                    lbl.text = top;
                    lbl.text_local = 1;
                    lv_area_t la1 = {(lv_coord_t)(sx + 8), (lv_coord_t)line_y,
                                      (lv_coord_t)(sx + 200), (lv_coord_t)(line_y + 14)};
                    lv_draw_label(layer, &lbl, &la1);
                    line_y += 14;
                }

                if (tag_data_shown()) {
                    // Same GND/FL###/exact-feet convention as the paint-detail
                    // zone below (and map_view.cpp, detail_card.cpp) -- this
                    // condensed zone used to round sub-18k feet to the
                    // nearest 100 and format FL without leading zeros,
                    // an inconsistency with everywhere else (reported).
                    char alt_str[12];
                    if (ac.on_ground) snprintf(alt_str, sizeof(alt_str), "GND");
                    else if (ac.altitude >= 18000) snprintf(alt_str, sizeof(alt_str), "FL%03d", ac.altitude / 100);
                    else snprintf(alt_str, sizeof(alt_str), "%d'", ac.altitude);
                    char info[24];
                    snprintf(info, sizeof(info), "%s %dkt", alt_str, ac.speed);
                    lv_draw_label_dsc_t il;
                    lv_draw_label_dsc_init(&il);
                    il.color = color;
                    il.font = &lv_font_montserrat_14;
                    il.opa = (uint8_t)(lbl_opa * 3 / 4);
                    il.text = info;
                    il.text_local = 1;
                    lv_area_t la2 = {(lv_coord_t)(sx + 8), (lv_coord_t)line_y,
                                      (lv_coord_t)(sx + 160), (lv_coord_t)(line_y + 14)};
                    lv_draw_label(layer, &il, &la2);
                }
            }
        }
    }

    _list->unlock();
}

// ============================================================
// Airport / Home reference markers -- ported from map_view.cpp, which had
// this and Radar didn't (backlog: "Airport markers on map/radar", Radar
// half). Radar gets its own monochrome-green palette instead of Map's
// runway-green/airport-blue-grey split, to stay consistent with the rest
// of this view's classic radar-scope look.
// ============================================================
#define COLOR_RADAR_RUNWAY    lv_color_hex(0x1a6633)
#define COLOR_RADAR_RWY_LABEL lv_color_hex(0x2ecc71)
#define COLOR_RADAR_AIRPORT   lv_color_hex(0x2d8f4f)

#define RADAR_RUNWAY_LABEL_SHOW_MAX_NM  10.0f
#define RADAR_RUNWAY_LABEL_BIG_FONT_NM  8.0f
#define RADAR_RUNWAY_LABEL_MIN_PX_FLOOR 12
#define RADAR_RUNWAY_LABEL_OFFSET       14
#define RADAR_RUNWAY_LBL_W_SMALL        30
#define RADAR_RUNWAY_LBL_H_SMALL        14
#define RADAR_RUNWAY_LBL_W_BIG          40
#define RADAR_RUNWAY_LBL_H_BIG          18

#define MAX_RADAR_LABEL_RECTS (MAX_LOCATIONS * MAX_RUNWAYS * 2)
#define RADAR_LABEL_OVERLAP_LIMIT_PCT 20

static bool radar_label_areas_overlap_too_much(const lv_area_t &a, const lv_area_t &b) {
    int32_t a_area = (int32_t)(a.x2 - a.x1) * (int32_t)(a.y2 - a.y1);
    int32_t ix1 = a.x1 > b.x1 ? a.x1 : b.x1;
    int32_t iy1 = a.y1 > b.y1 ? a.y1 : b.y1;
    int32_t ix2 = a.x2 < b.x2 ? a.x2 : b.x2;
    int32_t iy2 = a.y2 < b.y2 ? a.y2 : b.y2;
    if (ix2 <= ix1 || iy2 <= iy1) return false;
    int32_t overlap_area = (ix2 - ix1) * (iy2 - iy1);
    return overlap_area * 100 > a_area * RADAR_LABEL_OVERLAP_LIMIT_PCT;
}

static lv_area_t radar_label_area_at(int px, int py, int w, int h) {
    return {
        (lv_coord_t)(px - w / 2), (lv_coord_t)(py - h / 2),
        (lv_coord_t)(px + w / 2), (lv_coord_t)(py + h / 2)
    };
}

struct RadarLabelRectSet {
    lv_area_t rects[MAX_RADAR_LABEL_RECTS];
    int count = 0;
    bool overlaps(const lv_area_t &a) const {
        for (int i = 0; i < count; i++)
            if (radar_label_areas_overlap_too_much(a, rects[i])) return true;
        return false;
    }
    void add(const lv_area_t &a) {
        if (count < MAX_RADAR_LABEL_RECTS) rects[count++] = a;
    }
};

static void place_radar_runway_label(lv_layer_t *layer, lv_draw_label_dsc_t *lbl, RadarLabelRectSet &placed,
                                      int ex, int ey, float dirx, float diry, const char *text, int w, int h) {
    lv_area_t area = radar_label_area_at(ex + (int)(dirx * RADAR_RUNWAY_LABEL_OFFSET),
                                          ey + (int)(diry * RADAR_RUNWAY_LABEL_OFFSET), w, h);
    if (placed.overlaps(area)) {
        lv_area_t farther = radar_label_area_at(ex + (int)(dirx * RADAR_RUNWAY_LABEL_OFFSET * 2),
                                                 ey + (int)(diry * RADAR_RUNWAY_LABEL_OFFSET * 2), w, h);
        if (!placed.overlaps(farther)) area = farther;
    }
    lbl->text = text;
    lbl->text_local = 1; // runway/ICAO strings may not outlive unlock+async draw
    lv_draw_label(layer, lbl, &area);
    placed.add(area);
}

// Runway lines (always) and zoom-tiered designators for one Location --
// only drawn for the active location (see draw_radar_saved_airports()).
static void draw_radar_runways_for(lv_layer_t *layer, const Location *loc, RadarLabelRectSet &placed, float radius_nm) {
    lv_draw_line_dsc_t line;
    lv_draw_line_dsc_init(&line);
    line.color = COLOR_RADAR_RUNWAY;
    line.width = 1;

    bool show_labels = (radius_nm <= RADAR_RUNWAY_LABEL_SHOW_MAX_NM);
    bool big_font = (radius_nm <= RADAR_RUNWAY_LABEL_BIG_FONT_NM);
    int lbl_w = big_font ? RADAR_RUNWAY_LBL_W_BIG : RADAR_RUNWAY_LBL_W_SMALL;
    int lbl_h = big_font ? RADAR_RUNWAY_LBL_H_BIG : RADAR_RUNWAY_LBL_H_SMALL;
    int min_px = RADAR_RUNWAY_LABEL_MIN_PX_FLOOR;

    lv_draw_label_dsc_t lbl;
    if (show_labels) {
        lv_draw_label_dsc_init(&lbl);
        lbl.color = COLOR_RADAR_RWY_LABEL;
        lbl.font = big_font ? &lv_font_montserrat_14 : &lv_font_montserrat_10;
        lbl.align = LV_TEXT_ALIGN_CENTER;
    }

    for (int i = 0; i < loc->runway_count; i++) {
        const LocRunway &rw = loc->runways[i];
        int x1, y1, x2, y2;
        if (!to_radar_screen(rw.le_lat, rw.le_lon, x1, y1)) continue;
        if (!to_radar_screen(rw.he_lat, rw.he_lon, x2, y2)) continue;

        line.p1 = {(lv_value_precise_t)x1, (lv_value_precise_t)y1};
        line.p2 = {(lv_value_precise_t)x2, (lv_value_precise_t)y2};
        lv_draw_line(layer, &line);

        if (!show_labels) continue;

        float vx = (float)(x2 - x1);
        float vy = (float)(y2 - y1);
        float vlen = sqrtf(vx * vx + vy * vy);
        if (vlen < min_px) continue;
        vx /= vlen;
        vy /= vlen;

        place_radar_runway_label(layer, &lbl, placed, x1, y1, -vx, -vy, rw.le_id, lbl_w, lbl_h);
        place_radar_runway_label(layer, &lbl, placed, x2, y2, vx, vy, rw.he_id, lbl_w, lbl_h);
    }
}

#define RADAR_GLYPH_R 5

// Small "+ label" marker for a saved location we don't have runway geometry
// for -- see map_view.cpp's draw_airport_glyph() for the full reasoning
// (label is an ICAO for airports, a waypoint's own name otherwise).
static void draw_radar_airport_glyph(lv_layer_t *layer, int sx, int sy, const char *label) {
    lv_draw_line_dsc_t line;
    lv_draw_line_dsc_init(&line);
    line.color = COLOR_RADAR_AIRPORT;
    line.width = 1;
    line.opa = LV_OPA_70;

    line.p1 = {(lv_value_precise_t)(sx - RADAR_GLYPH_R), (lv_value_precise_t)sy};
    line.p2 = {(lv_value_precise_t)(sx + RADAR_GLYPH_R), (lv_value_precise_t)sy};
    lv_draw_line(layer, &line);
    line.p1 = {(lv_value_precise_t)sx, (lv_value_precise_t)(sy - RADAR_GLYPH_R)};
    line.p2 = {(lv_value_precise_t)sx, (lv_value_precise_t)(sy + RADAR_GLYPH_R)};
    lv_draw_line(layer, &line);

    lv_draw_label_dsc_t lbl;
    lv_draw_label_dsc_init(&lbl);
    lbl.color = COLOR_RADAR_AIRPORT;
    lbl.font = &lv_font_montserrat_14;
    lbl.opa = LV_OPA_80;
    lbl.text = label;
    lbl.text_local = 1;
    lv_area_t area = {(lv_coord_t)(sx + RADAR_GLYPH_R + 2), (lv_coord_t)(sy - 8),
                       (lv_coord_t)(sx + RADAR_GLYPH_R + 60), (lv_coord_t)(sy + 8)};
    lv_draw_label(layer, &lbl, &area);
}

// Small text-only ICAO label (no cross/glyph lines) for an airport drawn
// with full runway geometry via the nearby-runways cache -- see
// map_view.cpp's draw_airport_id_label() for the full reasoning (those
// airports skip draw_radar_airport_glyph() to avoid the double-draw bug,
// which otherwise left them with no on-screen identification at all).
static void draw_radar_airport_id_label(lv_layer_t *layer, const Location *loc, RadarLabelRectSet &placed) {
    int sx, sy;
    if (!to_radar_screen(loc->lat, loc->lon, sx, sy)) return;

    lv_draw_label_dsc_t lbl;
    lv_draw_label_dsc_init(&lbl);
    lbl.color = COLOR_RADAR_AIRPORT;
    lbl.font = &lv_font_montserrat_10;
    lbl.opa = LV_OPA_60;
    lbl.align = LV_TEXT_ALIGN_CENTER;

    place_radar_runway_label(layer, &lbl, placed, sx, sy, 0.0f, 1.0f, loc->icao, 50, 14);
}

// Every *saved* airport currently in range -- full runway geometry for
// whichever is active, a plain glyph for the rest (same reasoning as
// map_view.cpp: two full runway diagrams on screen at once isn't obviously
// "which one is here").
static void draw_radar_saved_airports(lv_layer_t *layer) {
    // static, not stack-local -- LVGL's draw callback runs on a small stack;
    // see map_view.cpp's identical note on its own LabelRectSet.
    static RadarLabelRectSet placed;
    placed.count = 0;
    float radius_nm = range_get_nm();
    int active = locations_active_index();
    int n = locations_count();

    // Nearby large airports (locations.h's nearby-runways cache) -- computed
    // first so the loop below can skip a redundant glyph for any non-active
    // saved airport that's also one of the active location's cached nearby
    // airports. See map_view.cpp's draw_saved_airports() for the full
    // reasoning (bug: nearby_start_scan() only excludes the owner's own
    // ICAO, not other saved locations, so such an airport got both a glyph
    // and full runways drawn on top of each other).
    int nearby_n;
    const Location *nearby = locations_nearby_get_active(&nearby_n);
    auto in_nearby_cache = [&](const char *icao) {
        for (int i = 0; i < nearby_n; i++)
            if (strcmp(nearby[i].icao, icao) == 0) return true;
        return false;
    };

    for (int i = 0; i < n; i++) {
        const Location *loc = locations_get(i);
        if (!loc) continue;
        int sx, sy;
        if (!to_radar_screen(loc->lat, loc->lon, sx, sy)) continue;

        if (i == active) {
            // See map_view.cpp's equivalent fix for the full reasoning --
            // the active location is already identified via the status-bar
            // picker chip, and an active waypoint already got its own
            // unlabeled marker from draw_radar_active_location_marker()
            // above, so there's nothing left to draw for it here.
            if (loc->runway_count > 0) draw_radar_runways_for(layer, loc, placed, radius_nm);
            continue;
        }
        if (in_nearby_cache(loc->icao)) {
            continue; // drawn with full runways by the nearby-cache pass below instead
        }
        // loc->name, not loc->icao -- icao is empty for a waypoint.
        draw_radar_airport_glyph(layer, sx, sy, loc->name);
    }

    for (int i = 0; i < nearby_n; i++) {
        if (nearby[i].runway_count > 0) {
            draw_radar_runways_for(layer, &nearby[i], placed, radius_nm);
            draw_radar_airport_id_label(layer, &nearby[i], placed);
        }
    }
}

#if HAS_AIRPORTS_DB
static bool radar_is_saved_icao(const char *icao) {
    int n = locations_count();
    for (int i = 0; i < n; i++) {
        const Location *loc = locations_get(i);
        if (loc && strcmp(loc->icao, icao) == 0) return true;
    }
    int nn;
    const Location *nearby = locations_nearby_get_active(&nn);
    for (int i = 0; i < nn; i++) {
        if (strcmp(nearby[i].icao, icao) == 0) return true;
    }
    return false;
}

// Passive "there's an airport here" markers from the static compiled-in DB
// -- skips anything already drawn with runways/glyph above (including the
// nearby-large-airport cache).
static void draw_radar_static_airport_glyphs(lv_layer_t *layer) {
    for (int i = 0; i < AIRPORTS_DB_COUNT; i++) {
        const StaticAirport &ap = airports_db[i];
        int sx, sy;
        if (!to_radar_screen(ap.lat, ap.lon, sx, sy)) continue;
        if (radar_is_saved_icao(ap.icao)) continue;
        draw_radar_airport_glyph(layer, sx, sy, ap.icao);
    }
}
#endif

// Marks the current center reference point -- the active location's own
// position -- skipped when that location already has its runway diagram
// drawn, same as map_view.cpp's draw_active_location_marker(). Same
// color/opacity as draw_radar_airport_glyph() uses for every other
// location's marker (previously full-opacity here, brighter than the rest
// despite sharing the same color -- reported).
static void draw_radar_active_location_marker(lv_layer_t *layer) {
    int active = locations_active_index();
    if (active == -1) return; // nothing selected -- see the empty-state overlay instead
    const Location *loc = locations_get(active);
    if (loc && loc->runway_count > 0) return;

    int hx, hy;
    if (!to_radar_screen(_proj.center_lat, _proj.center_lon, hx, hy)) return;

    lv_draw_line_dsc_t line_dsc;
    lv_draw_line_dsc_init(&line_dsc);
    line_dsc.color = COLOR_RADAR_AIRPORT;
    line_dsc.width = 1;
    line_dsc.opa = LV_OPA_70;

    line_dsc.p1 = {(lv_value_precise_t)(hx - 8), (lv_value_precise_t)hy};
    line_dsc.p2 = {(lv_value_precise_t)(hx + 8), (lv_value_precise_t)hy};
    lv_draw_line(layer, &line_dsc);

    line_dsc.p1 = {(lv_value_precise_t)hx, (lv_value_precise_t)(hy - 8)};
    line_dsc.p2 = {(lv_value_precise_t)hx, (lv_value_precise_t)(hy + 8)};
    lv_draw_line(layer, &line_dsc);
}

// Category + altitude legend -- radar had neither (reported). User asked
// for these to be printed the same as map's, not adapted to radar's own
// plain-square blip style -- so this is a near-verbatim port of map_view.cpp's
// draw_icon_legend()/draw_altitude_legend() (same icon shapes, same 6
// altitude bands), using the same measured local-y positions as
// map_view.cpp, anchored to LCD_V_RES so the legend stays pinned to the
// bottom of the screen on taller panels instead of the bare literals
// tuned for jc1060's 600px height (see project backlog: "bullseye/legend
// centering"). Shifted up twice now (4px, then another 8px) since the
// swipe bar kept overlapping it -- those margins are baked into the
// offsets below.
#define LEGEND_X0 4
#define LEGEND_W  248
#define LEGEND_ICON_Y (LCD_V_RES - 46)
#define LEGEND_ALT_Y  (LCD_V_RES - 28)
#define LEGEND_BOTTOM (LCD_V_RES - 14)

static void draw_radar_icon_legend(lv_layer_t *layer) {
    int y = LEGEND_ICON_Y;

    struct { const char *label; IconType type; lv_color_t color; } entries[] = {
        {"COM",  ICON_AIRLINER, COLOR_COMMERCIAL},
        {"GA",   ICON_GA,       COLOR_GA_PRIVATE},
        {"MIL",  ICON_JET,      COLOR_MILITARY},
        {"HELI", ICON_HELI,     COLOR_HELI_CAT},
    };

    int x = 8;
    for (int i = 0; i < 4; i++) {
        switch (entries[i].type) {
            case ICON_AIRLINER: draw_icon_airliner(layer, x + 6, y + 6, 0, 1, entries[i].color, LV_OPA_80); break;
            case ICON_JET:      draw_icon_jet(layer, x + 6, y + 6, 0, 1, entries[i].color, LV_OPA_80); break;
            case ICON_GA:       draw_icon_ga(layer, x + 6, y + 6, 0, 1, entries[i].color, LV_OPA_80); break;
            case ICON_HELI:     draw_icon_heli(layer, x + 6, y + 6, 0, 1, entries[i].color, LV_OPA_80); break;
        }

        lv_draw_label_dsc_t lbl;
        lv_draw_label_dsc_init(&lbl);
        lbl.color = entries[i].color;
        lbl.font = &lv_font_montserrat_14;
        lbl.opa = LV_OPA_80;
        lbl.text = entries[i].label;
        lbl.text_static = 1;
        lv_area_t la = {(lv_coord_t)(x + 16), (lv_coord_t)(y - 1),
                        (lv_coord_t)(x + 60), (lv_coord_t)(y + 14)};
        lv_draw_label(layer, &lbl, &la);

        x += 58;
    }
}

static void draw_radar_altitude_legend(lv_layer_t *layer) {
    struct { const char *label; lv_color_t color; } entries[] = {
        {"GND",  altitude_color(0)},
        {"<5k",  altitude_color(2500)},
        {"<15k", altitude_color(10000)},
        {"<25k", altitude_color(20000)},
        {"<35k", altitude_color(30000)},
        {"35k+", altitude_color(45000)},
    };

    int x = 8;
    int y = LEGEND_ALT_Y;

    for (int i = 0; i < 6; i++) {
        lv_draw_rect_dsc_t swatch;
        lv_draw_rect_dsc_init(&swatch);
        swatch.bg_color = entries[i].color;
        swatch.bg_opa = LV_OPA_COVER;
        swatch.radius = 2;
        lv_area_t sa = {(lv_coord_t)x, (lv_coord_t)y,
                        (lv_coord_t)(x + 8), (lv_coord_t)(y + 8)};
        lv_draw_rect(layer, &swatch, &sa);

        lv_draw_label_dsc_t lbl;
        lv_draw_label_dsc_init(&lbl);
        lbl.color = entries[i].color;
        lbl.font = &lv_font_montserrat_14;
        lbl.opa = LV_OPA_80;
        lbl.text = entries[i].label;
        lbl.text_static = 1;
        lv_area_t la = {(lv_coord_t)(x + 12), (lv_coord_t)(y - 2),
                        (lv_coord_t)(x + 60), (lv_coord_t)(y + 12)};
        lv_draw_label(layer, &lbl, &la);

        x += 58;
    }
}

static void draw_filter_label(lv_layer_t *layer) {
    char buf[128];
    lv_color_t color;
    if (filter_label_text(buf, sizeof(buf), &color) == 0) return;

    lv_draw_label_dsc_t lbl;
    lv_draw_label_dsc_init(&lbl);
    lbl.color = color;
    lbl.font = &lv_font_montserrat_14;
    lbl.opa = LV_OPA_COVER;
    lbl.text = buf;
    lbl.text_local = 1;
    lv_area_t la = {(lv_coord_t)8, (lv_coord_t)4,
                    (lv_coord_t)300, (lv_coord_t)20};
    lv_draw_label(layer, &lbl, &la);
}

static void radar_draw_cb(lv_event_t *e) {
    lv_layer_t *layer = lv_event_get_layer(e);
#if !defined(ARDUINO)
    uint32_t t_frame_start = millis();
    uint32_t t_start = t_frame_start, t;
#endif
    draw_rings(layer);
    // Secondary locations -- other airports + the active location's own
    // marker. Off gives the "just dots" look (VIEW menu, view_menu.cpp) --
    // the motivating case for this toggle in the first place.
    if (secondary_locations_shown()) {
        draw_radar_active_location_marker(layer);
#if HAS_AIRPORTS_DB
        draw_radar_static_airport_glyphs(layer);
#endif
        draw_radar_saved_airports(layer);
    }
#if !defined(ARDUINO)
    t = millis(); profile_record(_prof_rings, t - t_start); t_start = t;
#endif
    draw_sweep(layer); // profiles its own trail/bloomhub sub-phases internally
#if !defined(ARDUINO)
    t_start = millis();
#endif
    draw_blips(layer);
#if !defined(ARDUINO)
    t = millis(); profile_record(_prof_blips, t - t_start); t_start = t;
#endif
    // Legend on the map with no panel (matches map_view).
    draw_radar_icon_legend(layer);
    draw_radar_altitude_legend(layer);
    draw_filter_label(layer);
#if !defined(ARDUINO)
    t = millis();
    profile_record(_prof_legend, t - t_start);
    profile_record(_prof_total, t - t_frame_start);
    profile_maybe_log();
#endif
}

static void update_filter_visuals() {
    unsigned active = filter_get_active();
    for (int i = 0; i < NUM_FILTERS; i++) {
        if (active & (1u << i)) {
            lv_obj_set_style_bg_color(_filter_btns[i], filter_defs[i].color, 0);
            lv_obj_set_style_bg_opa(_filter_btns[i], LV_OPA_COVER, 0);
            lv_obj_set_style_border_color(_filter_btns[i], lv_color_hex(0xffffff), 0);
            lv_obj_set_style_border_width(_filter_btns[i], 2, 0);
            lv_obj_set_style_border_opa(_filter_btns[i], LV_OPA_COVER, 0);
            lv_obj_set_style_text_color(_filter_lbls[i], lv_color_hex(0x000000), 0);
        } else {
            lv_obj_set_style_bg_color(_filter_btns[i], lv_color_hex(0x0a0a1a), 0);
            lv_obj_set_style_bg_opa(_filter_btns[i], LV_OPA_70, 0);
            lv_obj_set_style_border_color(_filter_btns[i], filter_defs[i].color, 0);
            lv_obj_set_style_border_width(_filter_btns[i], 1, 0);
            lv_obj_set_style_border_opa(_filter_btns[i], LV_OPA_40, 0);
            lv_obj_set_style_text_color(_filter_lbls[i], lv_color_hex(0x666666), 0);
        }
    }
    if (_radar_obj) lv_obj_invalidate(_radar_obj);
}

static void update_gnd_visual(); // defined below -- radar_filter_click_cb needs it for VERT/GND mutual exclusion

static void radar_filter_click_cb(lv_event_t *e) {
    int idx = (int)(intptr_t)lv_event_get_user_data(e);
    _filter_just_clicked = true;
    filter_toggle(idx);
    update_filter_visuals();

    // VERT and GND are mutually exclusive -- see map_view.cpp's
    // filter_click_cb for the full rationale.
    if (idx == FILT_VERT && (filter_get_active() & (1u << FILT_VERT)) && !g_config.view_hide_ground[VIEW_RADAR]) {
        g_config.view_hide_ground[VIEW_RADAR] = true;
        storage_save_config(g_config);
        update_gnd_visual();
    }
}

#define COLOR_GND lv_color_hex(0x9c9482) // stone-grey, echoes the "GND" swatch in the altitude legend (altitude_color(0), geo.h) rather than an arbitrary hue

static void update_gnd_visual() {
    if (!_gnd_btn) return;
    // Lit = ground traffic currently SHOWN, matching every other filter
    // button's convention (lit = "you're seeing more of this"), not the
    // hide_ground boolean's own sense directly.
    if (!g_config.view_hide_ground[VIEW_RADAR]) {
        lv_obj_set_style_bg_color(_gnd_btn, COLOR_GND, 0);
        lv_obj_set_style_bg_opa(_gnd_btn, LV_OPA_COVER, 0);
        lv_obj_set_style_border_color(_gnd_btn, lv_color_hex(0xffffff), 0);
        lv_obj_set_style_border_width(_gnd_btn, 2, 0);
        lv_obj_set_style_border_opa(_gnd_btn, LV_OPA_COVER, 0);
        lv_obj_set_style_text_color(_gnd_lbl, lv_color_hex(0x000000), 0);
    } else {
        lv_obj_set_style_bg_color(_gnd_btn, lv_color_hex(0x0a0a1a), 0);
        lv_obj_set_style_bg_opa(_gnd_btn, LV_OPA_70, 0);
        lv_obj_set_style_border_color(_gnd_btn, COLOR_GND, 0);
        lv_obj_set_style_border_width(_gnd_btn, 1, 0);
        lv_obj_set_style_border_opa(_gnd_btn, LV_OPA_40, 0);
        lv_obj_set_style_text_color(_gnd_lbl, lv_color_hex(0x666666), 0);
    }
    if (_radar_obj) lv_obj_invalidate(_radar_obj);
}

static void gnd_click_cb(lv_event_t *e) {
    _filter_just_clicked = true;
    g_config.view_hide_ground[VIEW_RADAR] = !g_config.view_hide_ground[VIEW_RADAR];
    storage_save_config(g_config);
    update_gnd_visual();

    // Reverse direction -- see map_view.cpp's gnd_click_cb for the full
    // rationale.
    if (!g_config.view_hide_ground[VIEW_RADAR] && (filter_get_active() & (1u << FILT_VERT))) {
        filter_toggle(FILT_VERT);
        update_filter_visuals();
    }
}

void radar_view_init(lv_obj_t *parent, AircraftList *list) {
    _list = list;

    // Falls back to 0,0 if nothing's selected yet (fresh install) --
    // harmless, the per-tick active-location sync below re-centers for real
    // the moment a location is added and this stops being -1.
    float lat = 0, lon = 0;
    locations_get_active_coords(&lat, &lon, nullptr);
    _proj.center_lat = lat;
    _proj.center_lon = lon;
    _proj.radius_nm = range_get_nm();

    _radar_obj = lv_obj_create(parent);
    lv_obj_set_size(_radar_obj, RADAR_W, RADAR_H);
    lv_obj_set_pos(_radar_obj, 0, 0);
    lv_obj_set_style_bg_color(_radar_obj, COLOR_BG, 0);
    lv_obj_set_style_bg_opa(_radar_obj, LV_OPA_COVER, 0);
    lv_obj_set_style_border_width(_radar_obj, 0, 0);
    lv_obj_set_style_radius(_radar_obj, 0, 0);
    lv_obj_clear_flag(_radar_obj, LV_OBJ_FLAG_SCROLLABLE);
    lv_obj_clear_flag(_radar_obj, LV_OBJ_FLAG_SCROLL_CHAIN);
    views_attach_swipe(_radar_obj);

    lv_obj_add_event_cb(_radar_obj, radar_draw_cb, LV_EVENT_DRAW_MAIN_END, nullptr);

    lv_obj_add_event_cb(_radar_obj, [](lv_event_t *e) {
        if (views_get_active_index() != VIEW_RADAR) return;
        if (views_swipe_active()) { views_clear_swipe(); return; }

        if (_filter_just_clicked) {
            _filter_just_clicked = false;
            return;
        }

        lv_point_t point;
        lv_indev_get_point(lv_indev_active(), &point);
        int tx = point.x;
        int ty = point.y - 30;

        if (detail_card_is_visible()) {
            detail_card_hide();
            return;
        }

        // Hit test (30px radius) -- same filter/hide_ground gating as
        // draw_blips(), so a hidden aircraft can't be tapped.
        if (!_list->lock(pdMS_TO_TICKS(10))) return;
        for (int i = 0; i < _list->count; i++) {
            if (!aircraft_passes_filter(_list->aircraft[i])) continue;
            if (g_config.view_hide_ground[VIEW_RADAR] && _list->aircraft[i].on_ground) continue;
            int sx, sy;
            if (to_radar_screen(_list->aircraft[i].lat, _list->aircraft[i].lon, sx, sy)) {
                int dx = tx - sx;
                int dy = ty - sy;
                if (dx * dx + dy * dy < 900) {
                    Aircraft ac_copy = _list->aircraft[i];
                    _list->unlock();
                    detail_card_show(&ac_copy);
                    return;
                }
            }
        }
        _list->unlock();
    }, LV_EVENT_CLICKED, nullptr);

    // Filter toggle buttons — vertical stack on right edge (same layout as
    // map). FILT_VERT gets extra spacing and a thin divider above it -- see
    // map_view.cpp's copy of this loop for why.
    {
        int btn_w = 64, btn_h = 48, btn_gap = 10, group_gap_extra = 14;
        // +1 slot for GND, appended after VERT in the same state group
        int total_h = (NUM_FILTERS + 1) * btn_h + NUM_FILTERS * btn_gap + group_gap_extra;
        int btn_x = RADAR_W - btn_w - 8;
        int btn_y0 = (RADAR_H - total_h) / 2;
        for (int i = 0; i < NUM_FILTERS; i++) {
            int y = btn_y0 + i * (btn_h + btn_gap) + (i >= FILT_VERT ? group_gap_extra : 0);
            if (i == FILT_VERT) {
                lv_obj_t *div = lv_obj_create(parent);
                lv_obj_set_size(div, btn_w, 1);
                lv_obj_set_pos(div, btn_x, y - (btn_gap + group_gap_extra) / 2);
                lv_obj_set_style_bg_color(div, lv_color_hex(0x444466), 0);
                lv_obj_set_style_bg_opa(div, LV_OPA_COVER, 0);
                lv_obj_set_style_border_width(div, 0, 0);
                lv_obj_set_style_radius(div, 0, 0);
                lv_obj_clear_flag(div, LV_OBJ_FLAG_SCROLLABLE);
                lv_obj_clear_flag(div, LV_OBJ_FLAG_CLICKABLE);
            }
            lv_obj_t *btn = lv_obj_create(parent);
            lv_obj_set_size(btn, btn_w, btn_h);
            lv_obj_set_pos(btn, btn_x, y);
            lv_obj_set_style_bg_color(btn, lv_color_hex(0x0a0a1a), 0);
            lv_obj_set_style_bg_opa(btn, LV_OPA_70, 0);
            lv_obj_set_style_border_color(btn, filter_defs[i].color, 0);
            lv_obj_set_style_border_width(btn, 1, 0);
            lv_obj_set_style_border_opa(btn, LV_OPA_40, 0);
            lv_obj_set_style_radius(btn, 6, 0);
            lv_obj_set_style_pad_all(btn, 0, 0);
            lv_obj_clear_flag(btn, LV_OBJ_FLAG_SCROLLABLE);
            lv_obj_clear_flag(btn, LV_OBJ_FLAG_SCROLL_CHAIN);
            lv_obj_add_event_cb(btn, radar_filter_click_cb, LV_EVENT_CLICKED,
                                (void *)(intptr_t)i);

            lv_obj_t *lbl = lv_label_create(btn);
            lv_label_set_text(lbl, filter_defs[i].label);
            lv_obj_set_style_text_font(lbl, &lv_font_montserrat_16, 0);
            lv_obj_set_style_text_color(lbl, lv_color_hex(0x666666), 0);
            lv_obj_center(lbl);

            _filter_btns[i] = btn;
            _filter_lbls[i] = lbl;
        }

        // GND -- quick toggle for g_config.view_hide_ground[VIEW_RADAR], same state group as
        // VERT (see map_view.cpp's copy of this block for the full rationale)
        int y = btn_y0 + NUM_FILTERS * (btn_h + btn_gap) + group_gap_extra;
        _gnd_btn = lv_obj_create(parent);
        lv_obj_set_size(_gnd_btn, btn_w, btn_h);
        lv_obj_set_pos(_gnd_btn, btn_x, y);
        lv_obj_set_style_radius(_gnd_btn, 6, 0);
        lv_obj_set_style_pad_all(_gnd_btn, 0, 0);
        lv_obj_clear_flag(_gnd_btn, LV_OBJ_FLAG_SCROLLABLE);
        lv_obj_clear_flag(_gnd_btn, LV_OBJ_FLAG_SCROLL_CHAIN);
        lv_obj_add_event_cb(_gnd_btn, gnd_click_cb, LV_EVENT_CLICKED, nullptr);

        _gnd_lbl = lv_label_create(_gnd_btn);
        lv_label_set_text(_gnd_lbl, "GND");
        lv_obj_set_style_text_font(_gnd_lbl, &lv_font_montserrat_16, 0);
        lv_obj_center(_gnd_lbl);
        update_gnd_visual();
    }

    // Clear-trails and range are now shared chips in the status bar
    // (status_bar.cpp) -- see radar_view_clear_trails() below. This view
    // still tracks range_get_nm() itself further down to keep
    // _proj.radius_nm in sync.

    // Animate sweep — always update angle, but only redraw when visible and not touching
    _last_sweep_ms = millis();
    static unsigned _last_synced_filter = ~0u; // impossible bitmask value, forces sync on first tick
    static bool _last_synced_gnd = g_config.view_hide_ground[VIEW_RADAR];
    static float _last_range = -1;
    lv_timer_create([](lv_timer_t *t) {
        uint32_t now = millis();
        uint32_t dt = now - _last_sweep_ms;
        _last_sweep_ms = now;
        _sweep_angle += (360.0f * dt) / SWEEP_PERIOD_MS;
        if (_sweep_angle >= 360.0f) _sweep_angle -= 360.0f;

        // Follow the active location -- cheap check, no per-view "on_show"
        // hook exists for Radar so this runs every tick. (Used to also
        // re-point _list between a Home feed and a saved-location feed --
        // there's only one list now, see its declaration.)
        int active = locations_active_index();
        if (active != _last_active_loc) {
            _last_active_loc = active;
            float lat, lon;
            if (locations_get_active_coords(&lat, &lon, nullptr)) {
                _proj.center_lat = lat;
                _proj.center_lon = lon;
            }
        }

        // Only update when range actually changes
        float r = range_get_nm();
        if (r != _last_range) {
            _last_range = r;
            _proj.radius_nm = r;
        }

        // Sync filter button visuals if filter changed from another view
        unsigned af = filter_get_active();
        if (af != _last_synced_filter) {
            _last_synced_filter = af;
            update_filter_visuals();
        }
        if (g_config.view_hide_ground[VIEW_RADAR] != _last_synced_gnd) {
            _last_synced_gnd = g_config.view_hide_ground[VIEW_RADAR];
            update_gnd_visual();
        }

        // Skip rendering when touch is active — use global flag (lv_indev_active() is null in timers)
        if (touch_active) return;

        // Only invalidate when radar view is active
        if (views_get_active_index() == VIEW_RADAR) {
            lv_obj_invalidate(_radar_obj);
        }
    }, 100, nullptr);  // 10fps — frees CPU for touch processing
}

void radar_view_update() {
    if (_radar_obj) lv_obj_invalidate(_radar_obj);
}

// Called from the shared status bar chip (status_bar.cpp) when Radar is the
// active tab. Only affects this view's own drawing cutoff -- Map and Radar
// share the same underlying Aircraft/TrailPoint data, so this must never
// mutate it (that would clear both views at once).
void radar_view_clear_trails() {
    _trails_cleared_at = millis();
    if (_radar_obj) lv_obj_invalidate(_radar_obj);
}

