#include <Arduino.h>
#include "radar_view.h"
#include "views.h"
#include "status_bar.h"
#include "detail_card.h"
#include "filters.h"
#include "aircraft_icons.h" // legend now matches map's icon shapes -- see draw_radar_icon_legend()
#include "display_prefs.h"
#include "../pins_config.h"
#include "../data/storage.h"
#include "../data/locations.h"
#include "geo.h"
#include "range.h"
#include <cstring>

// Static large/medium airport glyph DB (generated by tools/generate_airports_db.py)
// -- same optional include as map_view.cpp.
#if __has_include("airports_db.h")
#include "airports_db.h"
#define HAS_AIRPORTS_DB 1
#else
#define HAS_AIRPORTS_DB 0
#endif

static AircraftList *_list = nullptr;      // currently effective list
static AircraftList *_home_list = nullptr; // the list passed in at init
static int _last_active_loc = -2;          // sentinel — -1 is a valid "Home"
static lv_obj_t *_radar_obj = nullptr;

static float _sweep_angle = 0.0f; // current sweep angle in degrees
static uint32_t _last_sweep_ms = 0;
// Per-view "clear trails" cutoff -- Map and Radar share the same underlying
// Aircraft/TrailPoint data, so clearing trails must not mutate that shared
// data (it would clear both views at once). Instead each view independently
// stops drawing any trail point older than its own cutoff.
static uint32_t _trails_cleared_at = 0;

#define RADAR_W LCD_H_RES
#define RADAR_H (LCD_V_RES - STATUS_BAR_HEIGHT)
#define RADAR_CX (RADAR_W / 2)
// RADAR_H is the canvas *object's* declared height (matches its tile) --
// kept as-is for the object's own size and the filter-button column, which
// are real LVGL layout needing the tile's actual bounds. RADAR_CY/RADAR_R
// below are *measured* fixed values instead (see project backlog:
// "bullseye/legend centering" -- a ruler overlay + a photo of the running
// hardware, not another guess): the tileview's "swipe bar" sits at
// canvas-local y~598, and the user wants the compass's vertical center at
// ~310 (partway between ruler marks 348 and 398, converted to local by
// subtracting STATUS_BAR_HEIGHT). Radius is fixed at 251 (unchanged from
// the last "keep the same size" pass). Same fixed center as map_view.cpp
// so both screens actually match -- previously each computed its own
// slightly different position from separate margin math.
//
// Note this affects aircraft position too, not just the compass --
// to_radar_screen() (used for both) derives its scale from RADAR_R/RADAR_CY
// directly, unlike map_view.cpp where the rings and _proj.screen_h are
// separate.
#define RADAR_CY 310
#define RADAR_R  251

#define SWEEP_PERIOD_MS 30000  // one full rotation = 30 seconds

#define COLOR_SWEEP lv_color_hex(0x00ff44)
#define COLOR_RING lv_color_hex(0x0a2a0a)
#define COLOR_TEXT lv_color_hex(0x00cc33)
#define COLOR_BG lv_color_hex(0x000800)

#define SWEEP_BRIGHT_DEG 60.0f        // full brightness boost zone
#define SWEEP_FADE_DEG   180.0f       // fade boost back to normal
#define BLIP_NORMAL_OPA  LV_OPA_90    // normal blip brightness
#define PAINT_DETAIL_DEG 45.0f        // expanded detail zone right after sweep
#define LABEL_VISIBLE_DEG 240.0f      // callsign label visibility zone

static MapProjection _proj;

// Per-view filter button/label pointers
static lv_obj_t *_filter_btns[NUM_FILTERS] = {};
static lv_obj_t *_filter_lbls[NUM_FILTERS] = {};
// GND is a quick-access toggle for g_config.view_hide_ground[VIEW_RADAR] -- not part of the
// FILT_* bitmask (unconditional exclude, not an OR/AND-able category or
// state match), but drawn in the same button stack, state group with VERT.
static lv_obj_t *_gnd_btn = nullptr;
static lv_obj_t *_gnd_lbl = nullptr;
static bool _filter_just_clicked = false;

// Convert lat/lon to radar-relative screen coords
static bool to_radar_screen(float lat, float lon, int &sx, int &sy) {
    float dx_nm = (lon - _proj.center_lon) * 60.0f * cosf(_proj.center_lat * M_PI / 180.0f);
    float dy_nm = (lat - _proj.center_lat) * 60.0f;
    float dist_nm = sqrtf(dx_nm * dx_nm + dy_nm * dy_nm);

    if (dist_nm > _proj.radius_nm) return false;

    float scale = (float)RADAR_R / _proj.radius_nm;
    sx = RADAR_CX + (int)(dx_nm * scale);
    sy = RADAR_CY - (int)(dy_nm * scale);
    return true;
}

// Get bearing angle (0=N, 90=E) from radar center to a screen point
static float blip_angle(int sx, int sy) {
    float dx = (float)(sx - RADAR_CX);
    float dy = (float)(RADAR_CY - sy); // invert Y (screen Y goes down)
    float angle = atan2f(dx, dy) * 180.0f / M_PI;
    if (angle < 0) angle += 360.0f;
    return angle;
}

// Angular distance from sweep to blip (how far behind the sweep the blip is)
static float angle_behind_sweep(float blip_deg) {
    float diff = _sweep_angle - blip_deg;
    if (diff < 0) diff += 360.0f;
    return diff; // 0 = just swept, 359 = about to be swept
}

static void draw_rings(lv_layer_t *layer) {
    lv_draw_arc_dsc_t arc;
    lv_draw_arc_dsc_init(&arc);
    arc.color = COLOR_RING;
    arc.width = 1;
    arc.start_angle = 0;
    arc.end_angle = 360;
    arc.center.x = RADAR_CX;
    arc.center.y = RADAR_CY;

    float range = range_get_nm();
    float ring_nm;
    if (range >= 100) ring_nm = 25.0f;
    else if (range >= 50) ring_nm = 10.0f;
    else if (range >= 20) ring_nm = 5.0f;
    else ring_nm = 1.0f;

    float scale = (float)RADAR_R / range;
    for (float r = ring_nm; r <= range; r += ring_nm) {
        arc.radius = (int)(r * scale);
        arc.center.x = RADAR_CX;
        arc.center.y = RADAR_CY;
        lv_draw_arc(layer, &arc);
    }

    // Cardinal direction labels
    const char *dirs[] = {"N", "E", "S", "W"};
    int dx[] = {0, 1, 0, -1};
    int dy[] = {-1, 0, 1, 0};
    lv_draw_label_dsc_t lbl;
    lv_draw_label_dsc_init(&lbl);
    lbl.color = COLOR_RING;
    lbl.font = &lv_font_montserrat_14;
    for (int i = 0; i < 4; i++) {
        int lx = RADAR_CX + dx[i] * (RADAR_R + 2) - 5;
        int ly = RADAR_CY + dy[i] * (RADAR_R + 2) - 7;
        lv_area_t area = {(lv_coord_t)lx, (lv_coord_t)ly,
                          (lv_coord_t)(lx + 20), (lv_coord_t)(ly + 16)};
        lbl.text = dirs[i];
        lv_draw_label(layer, &lbl, &area);
    }

    // Cross lines
    lv_draw_line_dsc_t line;
    lv_draw_line_dsc_init(&line);
    line.color = COLOR_RING;
    line.width = 1;
    line.opa = LV_OPA_30;
    line.p1 = {RADAR_CX, RADAR_CY - RADAR_R};
    line.p2 = {RADAR_CX, RADAR_CY + RADAR_R};
    lv_draw_line(layer, &line);
    line.p1 = {RADAR_CX - RADAR_R, RADAR_CY};
    line.p2 = {RADAR_CX + RADAR_R, RADAR_CY};
    lv_draw_line(layer, &line);
}

static void draw_sweep(lv_layer_t *layer) {
    float rad = _sweep_angle * M_PI / 180.0f;
    int ex = RADAR_CX + (int)(RADAR_R * sinf(rad));
    int ey = RADAR_CY - (int)(RADAR_R * cosf(rad));

    // Sweep line
    lv_draw_line_dsc_t line;
    lv_draw_line_dsc_init(&line);
    line.color = COLOR_SWEEP;
    line.width = 2;
    line.opa = LV_OPA_60;
    line.p1 = {RADAR_CX, RADAR_CY};
    line.p2 = {(lv_value_precise_t)ex, (lv_value_precise_t)ey};
    lv_draw_line(layer, &line);

    // Fading trail (draw 6 faded lines behind sweep)
    for (int i = 1; i <= 6; i++) {
        float trail_rad = (_sweep_angle - i * 3.0f) * M_PI / 180.0f;
        int tx = RADAR_CX + (int)(RADAR_R * sinf(trail_rad));
        int ty = RADAR_CY - (int)(RADAR_R * cosf(trail_rad));
        line.opa = LV_OPA_40 - i * 6;
        line.width = 1;
        line.p1 = {RADAR_CX, RADAR_CY};
        line.p2 = {(lv_value_precise_t)tx, (lv_value_precise_t)ty};
        lv_draw_line(layer, &line);
    }
}

static void draw_blips(lv_layer_t *layer) {
    if (!_list->lock(pdMS_TO_TICKS(5))) return; // short timeout: skip frame if data locked

    uint32_t now = millis();

    for (int i = 0; i < _list->count; i++) {
        Aircraft &ac = _list->aircraft[i];
        uint8_t ghost_opa = compute_aircraft_opacity(ac.stale_since, now);
        if (ghost_opa == 0) continue;
        if (!aircraft_passes_filter(ac)) continue;
        if (g_config.view_hide_ground[VIEW_RADAR] && ac.on_ground) continue;

        int sx, sy;
        if (!to_radar_screen(ac.lat, ac.lon, sx, sy)) continue;

        // Sweep boost: brief brightness flash when sweep passes, otherwise normal
        float behind = angle_behind_sweep(blip_angle(sx, sy));
        uint8_t sweep_opa;
        if (behind < SWEEP_BRIGHT_DEG) {
            sweep_opa = LV_OPA_COVER;
        } else if (behind < SWEEP_FADE_DEG) {
            float t = (behind - SWEEP_BRIGHT_DEG) / (SWEEP_FADE_DEG - SWEEP_BRIGHT_DEG);
            sweep_opa = LV_OPA_COVER - (uint8_t)(t * (LV_OPA_COVER - BLIP_NORMAL_OPA));
        } else {
            sweep_opa = BLIP_NORMAL_OPA;
        }

        // Combine sweep brightness with ghost fade (stale aircraft fade out)
        uint8_t opa = (uint8_t)((sweep_opa * ghost_opa) / 255);

        // Category color for blip -- on_ground overrides to gray
        // (altitude_color(0), matching the "GND" legend swatch) same as
        // map_view.cpp; emergency still wins over that.
        lv_color_t color;
        if (ac.is_emergency)  color = COLOR_EMERGENCY;
        else if (ac.on_ground)     color = altitude_color(0);
        else if (ac.is_military)   color = COLOR_MILITARY;
        else if ((ac.category[0] == 'A' && ac.category[1] == '7') ||
                 (ac.type_code[0] && is_heli_type(ac.type_code)))
            color = COLOR_HELI_CAT;
        else if (is_airline_callsign(ac.callsign) ||
                 (ac.category[0] == 'A' && ac.category[1] >= '3'))
            color = COLOR_COMMERCIAL;
        else
            color = COLOR_GA_PRIVATE;

        // Draw trail segments (if enabled) — altitude-colored. Per-view,
        // like Map -- see trails_shown()/trails_amount() (display_prefs.cpp).
        if (ac.trail_count > 1 && trails_shown()) {
            // Scale the effective cap by current zoom -- see the matching
            // comment in map_view.cpp for the full rationale.
            float radius_ratio = range_get_nm() / (float)g_config.radius_presets[3];
            if (radius_ratio > 1.0f) radius_ratio = 1.0f;
            int max_pts = (int)(trails_amount() * radius_ratio);
            if (max_pts < 3) max_pts = 3; // always show some trail, never fully vanish
            int start = (ac.trail_count > max_pts) ? ac.trail_count - max_pts : 0;
            lv_draw_rect_dsc_t tdot;
            lv_draw_rect_dsc_init(&tdot);
            tdot.radius = 1;
            for (int t = start; t < ac.trail_count; t++) {
                if (ac.trail[t].timestamp < _trails_cleared_at) continue;
                int tx, ty;
                if (to_radar_screen(ac.trail[t].lat, ac.trail[t].lon, tx, ty)) {
                    tdot.bg_color = altitude_color(ac.trail[t].alt);
                    uint8_t t_opa = (uint8_t)(LV_OPA_20 + ((t - start) * LV_OPA_40 / (ac.trail_count - start)));
                    tdot.bg_opa = (uint8_t)((t_opa * opa) / 255);
                    lv_area_t ta = {(lv_coord_t)(tx - 1), (lv_coord_t)(ty - 1),
                                    (lv_coord_t)(tx + 1), (lv_coord_t)(ty + 1)};
                    lv_draw_rect(layer, &tdot, &ta);
                }
            }
        }

        // Blip dot — larger for better visibility
        lv_draw_rect_dsc_t dot;
        lv_draw_rect_dsc_init(&dot);
        dot.bg_color = color;
        dot.bg_opa = opa;
        dot.radius = 4;
        lv_area_t area = {(lv_coord_t)(sx - 4), (lv_coord_t)(sy - 4),
                          (lv_coord_t)(sx + 4), (lv_coord_t)(sy + 4)};
        lv_draw_rect(layer, &dot, &area);

        // Labels — two zones: paint detail (0-45deg) and condensed
        // (45-240deg). Each of Flight ID / Alt-Speed / Type is independently
        // toggled by the status bar's VIEW menu (view_menu.cpp). Flight ID
        // falls back callsign -> registration -> ICAO hex, and never shows
        // registration once a callsign is showing (Type would otherwise
        // redundantly repeat it) -- so there's no separate "registration"
        // line anymore, unlike before this existed.
        if (behind < LABEL_VISIBLE_DEG && (tag_id_shown() || tag_data_shown() || tag_type_shown())) {
            uint8_t lbl_opa = opa > LV_OPA_50 ? LV_OPA_80 : opa;
            const char *id_text = ac.callsign[0] ? ac.callsign :
                                  (ac.registration[0] ? ac.registration : ac.icao_hex);

            if (behind < PAINT_DETAIL_DEG) {
                // === PAINT ZONE: expanded detail -- stack whichever of the
                // 3 fields are on, top to bottom ===
                int line_y = sy - 28;
                if (tag_id_shown()) {
                    char line1[48];
                    strlcpy(line1, id_text, sizeof(line1));
                    lv_draw_label_dsc_t l1;
                    lv_draw_label_dsc_init(&l1);
                    l1.color = color;
                    l1.font = &lv_font_montserrat_14;
                    l1.opa = LV_OPA_COVER;
                    l1.text = line1;
                    lv_area_t a1 = {(lv_coord_t)(sx + 8), (lv_coord_t)line_y,
                                    (lv_coord_t)(sx + 280), (lv_coord_t)(line_y + 14)};
                    lv_draw_label(layer, &l1, &a1);
                    line_y += 14;
                }

                if (tag_type_shown()) {
                    char line2[48] = {};
                    if (ac.owner_op[0]) strlcpy(line2, ac.owner_op, sizeof(line2));
                    else if (ac.desc[0]) strlcpy(line2, ac.desc, sizeof(line2));
                    else strlcpy(line2, ac.type_code, sizeof(line2));
                    lv_draw_label_dsc_t l2;
                    lv_draw_label_dsc_init(&l2);
                    l2.color = color;
                    l2.font = &lv_font_montserrat_14;
                    l2.opa = (uint8_t)(LV_OPA_COVER * 3 / 4);
                    l2.text = line2;
                    lv_area_t a2 = {(lv_coord_t)(sx + 8), (lv_coord_t)line_y,
                                    (lv_coord_t)(sx + 280), (lv_coord_t)(line_y + 14)};
                    lv_draw_label(layer, &l2, &a2);
                    line_y += 14;
                }

                if (tag_data_shown()) {
                    char line3[48];
                    char alt_str[12];
                    if (ac.on_ground) snprintf(alt_str, sizeof(alt_str), "GND");
                    else if (ac.altitude >= 18000) snprintf(alt_str, sizeof(alt_str), "FL%03d", ac.altitude / 100);
                    else snprintf(alt_str, sizeof(alt_str), "%d'", ac.altitude);
                    const char *vr_arrow = ac.vert_rate > 300 ? "^" : ac.vert_rate < -300 ? "v" : "";
                    snprintf(line3, sizeof(line3), "%s %dkt %s", alt_str, ac.speed, vr_arrow);
                    lv_draw_label_dsc_t l3;
                    lv_draw_label_dsc_init(&l3);
                    l3.color = color;
                    l3.font = &lv_font_montserrat_14;
                    l3.opa = (uint8_t)(LV_OPA_COVER * 2 / 3);
                    l3.text = line3;
                    lv_area_t a3 = {(lv_coord_t)(sx + 8), (lv_coord_t)line_y,
                                    (lv_coord_t)(sx + 280), (lv_coord_t)(line_y + 14)};
                    lv_draw_label(layer, &l3, &a3);
                }
            } else {
                // === CONDENSED ZONE: Flight ID + Alt/Speed only (Type was
                // never shown here even before this toggle system existed)
                int line_y = sy - 7;
                if (tag_id_shown()) {
                    char top[36];
                    strlcpy(top, id_text, sizeof(top));
                    lv_draw_label_dsc_t lbl;
                    lv_draw_label_dsc_init(&lbl);
                    lbl.color = color;
                    lbl.font = &lv_font_montserrat_14;
                    lbl.opa = lbl_opa;
                    lbl.text = top;
                    lv_area_t la1 = {(lv_coord_t)(sx + 8), (lv_coord_t)line_y,
                                      (lv_coord_t)(sx + 200), (lv_coord_t)(line_y + 14)};
                    lv_draw_label(layer, &lbl, &la1);
                    line_y += 14;
                }

                if (tag_data_shown()) {
                    // Same GND/FL###/exact-feet convention as the paint-detail
                    // zone below (and map_view.cpp, detail_card.cpp) -- this
                    // condensed zone used to round sub-18k feet to the
                    // nearest 100 and format FL without leading zeros,
                    // an inconsistency with everywhere else (reported).
                    char alt_str[12];
                    if (ac.on_ground) snprintf(alt_str, sizeof(alt_str), "GND");
                    else if (ac.altitude >= 18000) snprintf(alt_str, sizeof(alt_str), "FL%03d", ac.altitude / 100);
                    else snprintf(alt_str, sizeof(alt_str), "%d'", ac.altitude);
                    char info[24];
                    snprintf(info, sizeof(info), "%s %dkt", alt_str, ac.speed);
                    lv_draw_label_dsc_t il;
                    lv_draw_label_dsc_init(&il);
                    il.color = color;
                    il.font = &lv_font_montserrat_14;
                    il.opa = (uint8_t)(lbl_opa * 3 / 4);
                    il.text = info;
                    lv_area_t la2 = {(lv_coord_t)(sx + 8), (lv_coord_t)line_y,
                                      (lv_coord_t)(sx + 160), (lv_coord_t)(line_y + 14)};
                    lv_draw_label(layer, &il, &la2);
                }
            }
        }
    }

    _list->unlock();
}

// ============================================================
// Airport / Home reference markers -- ported from map_view.cpp, which had
// this and Radar didn't (backlog: "Airport markers on map/radar", Radar
// half). Radar gets its own monochrome-green palette instead of Map's
// runway-green/airport-blue-grey split, to stay consistent with the rest
// of this view's classic radar-scope look.
// ============================================================
#define COLOR_RADAR_RUNWAY    lv_color_hex(0x1a6633)
#define COLOR_RADAR_RWY_LABEL lv_color_hex(0x2ecc71)
#define COLOR_RADAR_AIRPORT   lv_color_hex(0x2d8f4f)

#define RADAR_RUNWAY_LABEL_SHOW_MAX_NM  10.0f
#define RADAR_RUNWAY_LABEL_BIG_FONT_NM  8.0f
#define RADAR_RUNWAY_LABEL_MIN_PX_FLOOR 12
#define RADAR_RUNWAY_LABEL_OFFSET       14
#define RADAR_RUNWAY_LBL_W_SMALL        30
#define RADAR_RUNWAY_LBL_H_SMALL        14
#define RADAR_RUNWAY_LBL_W_BIG          40
#define RADAR_RUNWAY_LBL_H_BIG          18

#define MAX_RADAR_LABEL_RECTS (MAX_LOCATIONS * MAX_RUNWAYS * 2)
#define RADAR_LABEL_OVERLAP_LIMIT_PCT 20

static bool radar_label_areas_overlap_too_much(const lv_area_t &a, const lv_area_t &b) {
    int32_t a_area = (int32_t)(a.x2 - a.x1) * (int32_t)(a.y2 - a.y1);
    int32_t ix1 = a.x1 > b.x1 ? a.x1 : b.x1;
    int32_t iy1 = a.y1 > b.y1 ? a.y1 : b.y1;
    int32_t ix2 = a.x2 < b.x2 ? a.x2 : b.x2;
    int32_t iy2 = a.y2 < b.y2 ? a.y2 : b.y2;
    if (ix2 <= ix1 || iy2 <= iy1) return false;
    int32_t overlap_area = (ix2 - ix1) * (iy2 - iy1);
    return overlap_area * 100 > a_area * RADAR_LABEL_OVERLAP_LIMIT_PCT;
}

static lv_area_t radar_label_area_at(int px, int py, int w, int h) {
    return {
        (lv_coord_t)(px - w / 2), (lv_coord_t)(py - h / 2),
        (lv_coord_t)(px + w / 2), (lv_coord_t)(py + h / 2)
    };
}

struct RadarLabelRectSet {
    lv_area_t rects[MAX_RADAR_LABEL_RECTS];
    int count = 0;
    bool overlaps(const lv_area_t &a) const {
        for (int i = 0; i < count; i++)
            if (radar_label_areas_overlap_too_much(a, rects[i])) return true;
        return false;
    }
    void add(const lv_area_t &a) {
        if (count < MAX_RADAR_LABEL_RECTS) rects[count++] = a;
    }
};

static void place_radar_runway_label(lv_layer_t *layer, lv_draw_label_dsc_t *lbl, RadarLabelRectSet &placed,
                                      int ex, int ey, float dirx, float diry, const char *text, int w, int h) {
    lv_area_t area = radar_label_area_at(ex + (int)(dirx * RADAR_RUNWAY_LABEL_OFFSET),
                                          ey + (int)(diry * RADAR_RUNWAY_LABEL_OFFSET), w, h);
    if (placed.overlaps(area)) {
        lv_area_t farther = radar_label_area_at(ex + (int)(dirx * RADAR_RUNWAY_LABEL_OFFSET * 2),
                                                 ey + (int)(diry * RADAR_RUNWAY_LABEL_OFFSET * 2), w, h);
        if (!placed.overlaps(farther)) area = farther;
    }
    lbl->text = text;
    lv_draw_label(layer, lbl, &area);
    placed.add(area);
}

// Runway lines (always) and zoom-tiered designators for one Location --
// only drawn for the active location (see draw_radar_saved_airports()).
static void draw_radar_runways_for(lv_layer_t *layer, const Location *loc, RadarLabelRectSet &placed, float radius_nm) {
    lv_draw_line_dsc_t line;
    lv_draw_line_dsc_init(&line);
    line.color = COLOR_RADAR_RUNWAY;
    line.width = 1;

    bool show_labels = (radius_nm <= RADAR_RUNWAY_LABEL_SHOW_MAX_NM);
    bool big_font = (radius_nm <= RADAR_RUNWAY_LABEL_BIG_FONT_NM);
    int lbl_w = big_font ? RADAR_RUNWAY_LBL_W_BIG : RADAR_RUNWAY_LBL_W_SMALL;
    int lbl_h = big_font ? RADAR_RUNWAY_LBL_H_BIG : RADAR_RUNWAY_LBL_H_SMALL;
    int min_px = RADAR_RUNWAY_LABEL_MIN_PX_FLOOR;

    lv_draw_label_dsc_t lbl;
    if (show_labels) {
        lv_draw_label_dsc_init(&lbl);
        lbl.color = COLOR_RADAR_RWY_LABEL;
        lbl.font = big_font ? &lv_font_montserrat_14 : &lv_font_montserrat_10;
        lbl.align = LV_TEXT_ALIGN_CENTER;
    }

    for (int i = 0; i < loc->runway_count; i++) {
        const LocRunway &rw = loc->runways[i];
        int x1, y1, x2, y2;
        if (!to_radar_screen(rw.le_lat, rw.le_lon, x1, y1)) continue;
        if (!to_radar_screen(rw.he_lat, rw.he_lon, x2, y2)) continue;

        line.p1 = {(lv_value_precise_t)x1, (lv_value_precise_t)y1};
        line.p2 = {(lv_value_precise_t)x2, (lv_value_precise_t)y2};
        lv_draw_line(layer, &line);

        if (!show_labels) continue;

        float vx = (float)(x2 - x1);
        float vy = (float)(y2 - y1);
        float vlen = sqrtf(vx * vx + vy * vy);
        if (vlen < min_px) continue;
        vx /= vlen;
        vy /= vlen;

        place_radar_runway_label(layer, &lbl, placed, x1, y1, -vx, -vy, rw.le_id, lbl_w, lbl_h);
        place_radar_runway_label(layer, &lbl, placed, x2, y2, vx, vy, rw.he_id, lbl_w, lbl_h);
    }
}

#define RADAR_GLYPH_R 5

// Small "+ ICAO" marker for an airport we don't have runway geometry for.
static void draw_radar_airport_glyph(lv_layer_t *layer, int sx, int sy, const char *icao) {
    lv_draw_line_dsc_t line;
    lv_draw_line_dsc_init(&line);
    line.color = COLOR_RADAR_AIRPORT;
    line.width = 1;
    line.opa = LV_OPA_70;

    line.p1 = {(lv_value_precise_t)(sx - RADAR_GLYPH_R), (lv_value_precise_t)sy};
    line.p2 = {(lv_value_precise_t)(sx + RADAR_GLYPH_R), (lv_value_precise_t)sy};
    lv_draw_line(layer, &line);
    line.p1 = {(lv_value_precise_t)sx, (lv_value_precise_t)(sy - RADAR_GLYPH_R)};
    line.p2 = {(lv_value_precise_t)sx, (lv_value_precise_t)(sy + RADAR_GLYPH_R)};
    lv_draw_line(layer, &line);

    lv_draw_label_dsc_t lbl;
    lv_draw_label_dsc_init(&lbl);
    lbl.color = COLOR_RADAR_AIRPORT;
    lbl.font = &lv_font_montserrat_14;
    lbl.opa = LV_OPA_80;
    lbl.text = icao;
    lv_area_t area = {(lv_coord_t)(sx + RADAR_GLYPH_R + 2), (lv_coord_t)(sy - 8),
                       (lv_coord_t)(sx + RADAR_GLYPH_R + 60), (lv_coord_t)(sy + 8)};
    lv_draw_label(layer, &lbl, &area);
}

// Every *saved* airport currently in range -- full runway geometry for
// whichever is active, a plain glyph for the rest (same reasoning as
// map_view.cpp: two full runway diagrams on screen at once isn't obviously
// "which one is here").
static void draw_radar_saved_airports(lv_layer_t *layer) {
    // static, not stack-local -- LVGL's draw callback runs on a small stack;
    // see map_view.cpp's identical note on its own LabelRectSet.
    static RadarLabelRectSet placed;
    placed.count = 0;
    float radius_nm = range_get_nm();
    int active = locations_active_index();
    int n = locations_count();
    for (int i = 0; i < n; i++) {
        const Location *loc = locations_get(i);
        if (!loc) continue;
        int sx, sy;
        if (!to_radar_screen(loc->lat, loc->lon, sx, sy)) continue;

        if (loc->runway_count > 0 && i == active) {
            draw_radar_runways_for(layer, loc, placed, radius_nm);
        } else {
            draw_radar_airport_glyph(layer, sx, sy, loc->icao);
        }
    }
}

#if HAS_AIRPORTS_DB
static bool radar_is_saved_icao(const char *icao) {
    int n = locations_count();
    for (int i = 0; i < n; i++) {
        const Location *loc = locations_get(i);
        if (loc && strcmp(loc->icao, icao) == 0) return true;
    }
    return false;
}

// Passive "there's an airport here" markers from the static compiled-in DB
// -- skips anything already drawn with runways/glyph above.
static void draw_radar_static_airport_glyphs(lv_layer_t *layer) {
    for (int i = 0; i < AIRPORTS_DB_COUNT; i++) {
        const StaticAirport &ap = airports_db[i];
        int sx, sy;
        if (!to_radar_screen(ap.lat, ap.lon, sx, sy)) continue;
        if (radar_is_saved_icao(ap.icao)) continue;
        draw_radar_airport_glyph(layer, sx, sy, ap.icao);
    }
}
#endif

// Marks the current center reference point (Home, or the active saved
// airport) -- skipped when that location already has its runway diagram
// drawn, same as map_view.cpp's draw_home_marker().
static void draw_radar_home_marker(lv_layer_t *layer) {
    int active = locations_active_index();
    if (active != -1) {
        const Location *loc = locations_get(active);
        if (loc && loc->runway_count > 0) return;
    }

    int hx, hy;
    if (!to_radar_screen(_proj.center_lat, _proj.center_lon, hx, hy)) return;

    lv_draw_line_dsc_t line_dsc;
    lv_draw_line_dsc_init(&line_dsc);
    line_dsc.color = COLOR_RADAR_AIRPORT;
    line_dsc.width = 1;

    line_dsc.p1 = {(lv_value_precise_t)(hx - 8), (lv_value_precise_t)hy};
    line_dsc.p2 = {(lv_value_precise_t)(hx + 8), (lv_value_precise_t)hy};
    lv_draw_line(layer, &line_dsc);

    line_dsc.p1 = {(lv_value_precise_t)hx, (lv_value_precise_t)(hy - 8)};
    line_dsc.p2 = {(lv_value_precise_t)hx, (lv_value_precise_t)(hy + 8)};
    lv_draw_line(layer, &line_dsc);
}

// Marks where Home actually is when it's NOT the active location -- same
// reasoning as map_view.cpp's draw_home_reference_elsewhere(): a filled dot
// rather than the "+" cross already used above, so it doesn't read as just
// another one of those.
static void draw_radar_home_reference_elsewhere(lv_layer_t *layer) {
    if (locations_active_index() == -1) return;

    int hx, hy;
    if (!to_radar_screen(g_config.home_lat, g_config.home_lon, hx, hy)) return;

    lv_draw_rect_dsc_t dot;
    lv_draw_rect_dsc_init(&dot);
    dot.bg_color = COLOR_RADAR_AIRPORT;
    dot.bg_opa = LV_OPA_70;
    dot.radius = LV_RADIUS_CIRCLE;
    lv_area_t area = {(lv_coord_t)(hx - 3), (lv_coord_t)(hy - 3),
                       (lv_coord_t)(hx + 3), (lv_coord_t)(hy + 3)};
    lv_draw_rect(layer, &dot, &area);

    lv_draw_label_dsc_t lbl;
    lv_draw_label_dsc_init(&lbl);
    lbl.color = COLOR_RADAR_AIRPORT;
    lbl.font = &lv_font_montserrat_14;
    lbl.opa = LV_OPA_80;
    lbl.text = "HOME";
    lv_area_t larea = {(lv_coord_t)(hx + 6), (lv_coord_t)(hy - 8),
                        (lv_coord_t)(hx + 60), (lv_coord_t)(hy + 8)};
    lv_draw_label(layer, &lbl, &larea);
}

// Category + altitude legend -- radar had neither (reported). User asked
// for these to be printed the same as map's, not adapted to radar's own
// plain-square blip style -- so this is a near-verbatim port of map_view.cpp's
// draw_icon_legend()/draw_altitude_legend() (same icon shapes, same 6
// altitude bands), using the same measured, fixed local-y positions as
// map_view.cpp (see project backlog: "bullseye/legend centering"). Shifted
// up twice now (4px, then another 8px) since the swipe bar kept
// overlapping it.
#define LEGEND_X0 4
#define LEGEND_W  248
#define LEGEND_ICON_Y 554
#define LEGEND_ALT_Y  572
#define LEGEND_BOTTOM 586

// Solid backdrop behind both legend rows -- see map_view.cpp's
// draw_legend_backdrop() for the full rationale (an airport/aircraft label
// rendering underneath would otherwise read as jumbled overlapping text).
static void draw_radar_legend_backdrop(lv_layer_t *layer) {
    lv_draw_rect_dsc_t bg;
    lv_draw_rect_dsc_init(&bg);
    bg.bg_color = COLOR_BG;
    bg.bg_opa = LV_OPA_COVER;
    bg.radius = 6;
    lv_area_t a = {(lv_coord_t)LEGEND_X0, (lv_coord_t)(LEGEND_ICON_Y - 6),
                   (lv_coord_t)(LEGEND_X0 + LEGEND_W), (lv_coord_t)LEGEND_BOTTOM};
    lv_draw_rect(layer, &bg, &a);
}

static void draw_radar_icon_legend(lv_layer_t *layer) {
    int y = LEGEND_ICON_Y;

    struct { const char *label; IconType type; lv_color_t color; } entries[] = {
        {"COM",  ICON_AIRLINER, COLOR_COMMERCIAL},
        {"GA",   ICON_GA,       COLOR_GA_PRIVATE},
        {"MIL",  ICON_JET,      COLOR_MILITARY},
        {"HELI", ICON_HELI,     COLOR_HELI_CAT},
    };

    int x = 8;
    for (int i = 0; i < 4; i++) {
        switch (entries[i].type) {
            case ICON_AIRLINER: draw_icon_airliner(layer, x + 6, y + 6, 0, 1, entries[i].color, LV_OPA_80); break;
            case ICON_JET:      draw_icon_jet(layer, x + 6, y + 6, 0, 1, entries[i].color, LV_OPA_80); break;
            case ICON_GA:       draw_icon_ga(layer, x + 6, y + 6, 0, 1, entries[i].color, LV_OPA_80); break;
            case ICON_HELI:     draw_icon_heli(layer, x + 6, y + 6, 0, 1, entries[i].color, LV_OPA_80); break;
        }

        lv_draw_label_dsc_t lbl;
        lv_draw_label_dsc_init(&lbl);
        lbl.color = entries[i].color;
        lbl.font = &lv_font_montserrat_14;
        lbl.opa = LV_OPA_80;
        lbl.text = entries[i].label;
        lv_area_t la = {(lv_coord_t)(x + 16), (lv_coord_t)(y - 1),
                        (lv_coord_t)(x + 60), (lv_coord_t)(y + 14)};
        lv_draw_label(layer, &lbl, &la);

        x += 58;
    }
}

static void draw_radar_altitude_legend(lv_layer_t *layer) {
    struct { const char *label; lv_color_t color; } entries[] = {
        {"GND",  altitude_color(0)},
        {"<5k",  altitude_color(2500)},
        {"<15k", altitude_color(10000)},
        {"<25k", altitude_color(20000)},
        {"<35k", altitude_color(30000)},
        {"35k+", altitude_color(45000)},
    };

    int x = 8;
    int y = LEGEND_ALT_Y;

    for (int i = 0; i < 6; i++) {
        lv_draw_rect_dsc_t swatch;
        lv_draw_rect_dsc_init(&swatch);
        swatch.bg_color = entries[i].color;
        swatch.bg_opa = LV_OPA_COVER;
        swatch.radius = 2;
        lv_area_t sa = {(lv_coord_t)x, (lv_coord_t)y,
                        (lv_coord_t)(x + 8), (lv_coord_t)(y + 8)};
        lv_draw_rect(layer, &swatch, &sa);

        lv_draw_label_dsc_t lbl;
        lv_draw_label_dsc_init(&lbl);
        lbl.color = entries[i].color;
        lbl.font = &lv_font_montserrat_14;
        lbl.opa = LV_OPA_80;
        lbl.text = entries[i].label;
        lv_area_t la = {(lv_coord_t)(x + 12), (lv_coord_t)(y - 2),
                        (lv_coord_t)(x + 60), (lv_coord_t)(y + 12)};
        lv_draw_label(layer, &lbl, &la);

        x += 58;
    }
}

static void draw_filter_label(lv_layer_t *layer) {
    char buf[128];
    lv_color_t color;
    if (filter_label_text(buf, sizeof(buf), &color) == 0) return;

    lv_draw_label_dsc_t lbl;
    lv_draw_label_dsc_init(&lbl);
    lbl.color = color;
    lbl.font = &lv_font_montserrat_14;
    lbl.opa = LV_OPA_COVER;
    lbl.text = buf;
    lv_area_t la = {(lv_coord_t)8, (lv_coord_t)4,
                    (lv_coord_t)300, (lv_coord_t)20};
    lv_draw_label(layer, &lbl, &la);
}

static void radar_draw_cb(lv_event_t *e) {
    lv_layer_t *layer = lv_event_get_layer(e);
    draw_rings(layer);
    // Secondary locations -- other airports + HOME-elsewhere marker.
    // Off gives the "just dots" look (VIEW menu, view_menu.cpp) -- the
    // motivating case for this toggle in the first place.
    if (secondary_locations_shown()) {
        draw_radar_home_marker(layer);
        draw_radar_home_reference_elsewhere(layer);
#if HAS_AIRPORTS_DB
        draw_radar_static_airport_glyphs(layer);
#endif
        draw_radar_saved_airports(layer);
    }
    draw_sweep(layer);
    draw_blips(layer);
    draw_radar_legend_backdrop(layer);
    draw_radar_icon_legend(layer);
    draw_radar_altitude_legend(layer);
    draw_filter_label(layer);
}

static void update_filter_visuals() {
    unsigned active = filter_get_active();
    for (int i = 0; i < NUM_FILTERS; i++) {
        if (active & (1u << i)) {
            lv_obj_set_style_bg_color(_filter_btns[i], filter_defs[i].color, 0);
            lv_obj_set_style_bg_opa(_filter_btns[i], LV_OPA_COVER, 0);
            lv_obj_set_style_border_color(_filter_btns[i], lv_color_hex(0xffffff), 0);
            lv_obj_set_style_border_width(_filter_btns[i], 2, 0);
            lv_obj_set_style_border_opa(_filter_btns[i], LV_OPA_COVER, 0);
            lv_obj_set_style_text_color(_filter_lbls[i], lv_color_hex(0x000000), 0);
        } else {
            lv_obj_set_style_bg_color(_filter_btns[i], lv_color_hex(0x0a0a1a), 0);
            lv_obj_set_style_bg_opa(_filter_btns[i], LV_OPA_70, 0);
            lv_obj_set_style_border_color(_filter_btns[i], filter_defs[i].color, 0);
            lv_obj_set_style_border_width(_filter_btns[i], 1, 0);
            lv_obj_set_style_border_opa(_filter_btns[i], LV_OPA_40, 0);
            lv_obj_set_style_text_color(_filter_lbls[i], lv_color_hex(0x666666), 0);
        }
    }
    if (_radar_obj) lv_obj_invalidate(_radar_obj);
}

static void update_gnd_visual(); // defined below -- radar_filter_click_cb needs it for VERT/GND mutual exclusion

static void radar_filter_click_cb(lv_event_t *e) {
    int idx = (int)(intptr_t)lv_event_get_user_data(e);
    _filter_just_clicked = true;
    filter_toggle(idx);
    update_filter_visuals();

    // VERT and GND are mutually exclusive -- see map_view.cpp's
    // filter_click_cb for the full rationale.
    if (idx == FILT_VERT && (filter_get_active() & (1u << FILT_VERT)) && !g_config.view_hide_ground[VIEW_RADAR]) {
        g_config.view_hide_ground[VIEW_RADAR] = true;
        storage_save_config(g_config);
        update_gnd_visual();
    }
}

#define COLOR_GND lv_color_hex(0x9c9482) // stone-grey, echoes the "GND" swatch in the altitude legend (altitude_color(0), geo.h) rather than an arbitrary hue

static void update_gnd_visual() {
    if (!_gnd_btn) return;
    // Lit = ground traffic currently SHOWN, matching every other filter
    // button's convention (lit = "you're seeing more of this"), not the
    // hide_ground boolean's own sense directly.
    if (!g_config.view_hide_ground[VIEW_RADAR]) {
        lv_obj_set_style_bg_color(_gnd_btn, COLOR_GND, 0);
        lv_obj_set_style_bg_opa(_gnd_btn, LV_OPA_COVER, 0);
        lv_obj_set_style_border_color(_gnd_btn, lv_color_hex(0xffffff), 0);
        lv_obj_set_style_border_width(_gnd_btn, 2, 0);
        lv_obj_set_style_border_opa(_gnd_btn, LV_OPA_COVER, 0);
        lv_obj_set_style_text_color(_gnd_lbl, lv_color_hex(0x000000), 0);
    } else {
        lv_obj_set_style_bg_color(_gnd_btn, lv_color_hex(0x0a0a1a), 0);
        lv_obj_set_style_bg_opa(_gnd_btn, LV_OPA_70, 0);
        lv_obj_set_style_border_color(_gnd_btn, COLOR_GND, 0);
        lv_obj_set_style_border_width(_gnd_btn, 1, 0);
        lv_obj_set_style_border_opa(_gnd_btn, LV_OPA_40, 0);
        lv_obj_set_style_text_color(_gnd_lbl, lv_color_hex(0x666666), 0);
    }
    if (_radar_obj) lv_obj_invalidate(_radar_obj);
}

static void gnd_click_cb(lv_event_t *e) {
    _filter_just_clicked = true;
    g_config.view_hide_ground[VIEW_RADAR] = !g_config.view_hide_ground[VIEW_RADAR];
    storage_save_config(g_config);
    update_gnd_visual();

    // Reverse direction -- see map_view.cpp's gnd_click_cb for the full
    // rationale.
    if (!g_config.view_hide_ground[VIEW_RADAR] && (filter_get_active() & (1u << FILT_VERT))) {
        filter_toggle(FILT_VERT);
        update_filter_visuals();
    }
}

void radar_view_init(lv_obj_t *parent, AircraftList *list) {
    _list = list;
    _home_list = list;

    _proj.center_lat = g_config.home_lat;
    _proj.center_lon = g_config.home_lon;
    _proj.radius_nm = range_get_nm();

    _radar_obj = lv_obj_create(parent);
    lv_obj_set_size(_radar_obj, RADAR_W, RADAR_H);
    lv_obj_set_pos(_radar_obj, 0, 0);
    lv_obj_set_style_bg_color(_radar_obj, COLOR_BG, 0);
    lv_obj_set_style_bg_opa(_radar_obj, LV_OPA_COVER, 0);
    lv_obj_set_style_border_width(_radar_obj, 0, 0);
    lv_obj_set_style_radius(_radar_obj, 0, 0);
    lv_obj_clear_flag(_radar_obj, LV_OBJ_FLAG_SCROLLABLE);
    lv_obj_clear_flag(_radar_obj, LV_OBJ_FLAG_SCROLL_CHAIN);
    views_attach_swipe(_radar_obj);

    lv_obj_add_event_cb(_radar_obj, radar_draw_cb, LV_EVENT_DRAW_MAIN_END, nullptr);

    lv_obj_add_event_cb(_radar_obj, [](lv_event_t *e) {
        if (views_get_active_index() != VIEW_RADAR) return;
        if (views_swipe_active()) { views_clear_swipe(); return; }

        if (_filter_just_clicked) {
            _filter_just_clicked = false;
            return;
        }

        lv_point_t point;
        lv_indev_get_point(lv_indev_active(), &point);
        int tx = point.x;
        int ty = point.y - 30;

        if (detail_card_is_visible()) {
            detail_card_hide();
            return;
        }

        // Hit test (30px radius) -- same filter/hide_ground gating as
        // draw_blips(), so a hidden aircraft can't be tapped.
        if (!_list->lock(pdMS_TO_TICKS(10))) return;
        for (int i = 0; i < _list->count; i++) {
            if (!aircraft_passes_filter(_list->aircraft[i])) continue;
            if (g_config.view_hide_ground[VIEW_RADAR] && _list->aircraft[i].on_ground) continue;
            int sx, sy;
            if (to_radar_screen(_list->aircraft[i].lat, _list->aircraft[i].lon, sx, sy)) {
                int dx = tx - sx;
                int dy = ty - sy;
                if (dx * dx + dy * dy < 900) {
                    Aircraft ac_copy = _list->aircraft[i];
                    _list->unlock();
                    detail_card_show(&ac_copy);
                    return;
                }
            }
        }
        _list->unlock();
    }, LV_EVENT_CLICKED, nullptr);

    // Filter toggle buttons — vertical stack on right edge (same layout as
    // map). FILT_VERT gets extra spacing and a thin divider above it -- see
    // map_view.cpp's copy of this loop for why.
    {
        int btn_w = 64, btn_h = 48, btn_gap = 10, group_gap_extra = 14;
        // +1 slot for GND, appended after VERT in the same state group
        int total_h = (NUM_FILTERS + 1) * btn_h + NUM_FILTERS * btn_gap + group_gap_extra;
        int btn_x = RADAR_W - btn_w - 8;
        int btn_y0 = (RADAR_H - total_h) / 2;
        for (int i = 0; i < NUM_FILTERS; i++) {
            int y = btn_y0 + i * (btn_h + btn_gap) + (i >= FILT_VERT ? group_gap_extra : 0);
            if (i == FILT_VERT) {
                lv_obj_t *div = lv_obj_create(parent);
                lv_obj_set_size(div, btn_w, 1);
                lv_obj_set_pos(div, btn_x, y - (btn_gap + group_gap_extra) / 2);
                lv_obj_set_style_bg_color(div, lv_color_hex(0x444466), 0);
                lv_obj_set_style_bg_opa(div, LV_OPA_COVER, 0);
                lv_obj_set_style_border_width(div, 0, 0);
                lv_obj_set_style_radius(div, 0, 0);
                lv_obj_clear_flag(div, LV_OBJ_FLAG_SCROLLABLE);
                lv_obj_clear_flag(div, LV_OBJ_FLAG_CLICKABLE);
            }
            lv_obj_t *btn = lv_obj_create(parent);
            lv_obj_set_size(btn, btn_w, btn_h);
            lv_obj_set_pos(btn, btn_x, y);
            lv_obj_set_style_bg_color(btn, lv_color_hex(0x0a0a1a), 0);
            lv_obj_set_style_bg_opa(btn, LV_OPA_70, 0);
            lv_obj_set_style_border_color(btn, filter_defs[i].color, 0);
            lv_obj_set_style_border_width(btn, 1, 0);
            lv_obj_set_style_border_opa(btn, LV_OPA_40, 0);
            lv_obj_set_style_radius(btn, 6, 0);
            lv_obj_set_style_pad_all(btn, 0, 0);
            lv_obj_clear_flag(btn, LV_OBJ_FLAG_SCROLLABLE);
            lv_obj_clear_flag(btn, LV_OBJ_FLAG_SCROLL_CHAIN);
            lv_obj_add_event_cb(btn, radar_filter_click_cb, LV_EVENT_CLICKED,
                                (void *)(intptr_t)i);

            lv_obj_t *lbl = lv_label_create(btn);
            lv_label_set_text(lbl, filter_defs[i].label);
            lv_obj_set_style_text_font(lbl, &lv_font_montserrat_16, 0);
            lv_obj_set_style_text_color(lbl, lv_color_hex(0x666666), 0);
            lv_obj_center(lbl);

            _filter_btns[i] = btn;
            _filter_lbls[i] = lbl;
        }

        // GND -- quick toggle for g_config.view_hide_ground[VIEW_RADAR], same state group as
        // VERT (see map_view.cpp's copy of this block for the full rationale)
        int y = btn_y0 + NUM_FILTERS * (btn_h + btn_gap) + group_gap_extra;
        _gnd_btn = lv_obj_create(parent);
        lv_obj_set_size(_gnd_btn, btn_w, btn_h);
        lv_obj_set_pos(_gnd_btn, btn_x, y);
        lv_obj_set_style_radius(_gnd_btn, 6, 0);
        lv_obj_set_style_pad_all(_gnd_btn, 0, 0);
        lv_obj_clear_flag(_gnd_btn, LV_OBJ_FLAG_SCROLLABLE);
        lv_obj_clear_flag(_gnd_btn, LV_OBJ_FLAG_SCROLL_CHAIN);
        lv_obj_add_event_cb(_gnd_btn, gnd_click_cb, LV_EVENT_CLICKED, nullptr);

        _gnd_lbl = lv_label_create(_gnd_btn);
        lv_label_set_text(_gnd_lbl, "GND");
        lv_obj_set_style_text_font(_gnd_lbl, &lv_font_montserrat_16, 0);
        lv_obj_center(_gnd_lbl);
        update_gnd_visual();
    }

    // Clear-trails and range are now shared chips in the status bar
    // (status_bar.cpp) -- see radar_view_clear_trails() below. This view
    // still tracks range_get_nm() itself further down to keep
    // _proj.radius_nm in sync.

    // Animate sweep — always update angle, but only redraw when visible and not touching
    _last_sweep_ms = millis();
    static unsigned _last_synced_filter = ~0u; // impossible bitmask value, forces sync on first tick
    static bool _last_synced_gnd = g_config.view_hide_ground[VIEW_RADAR];
    static float _last_range = -1;
    lv_timer_create([](lv_timer_t *t) {
        uint32_t now = millis();
        uint32_t dt = now - _last_sweep_ms;
        _last_sweep_ms = now;
        _sweep_angle += (360.0f * dt) / SWEEP_PERIOD_MS;
        if (_sweep_angle >= 360.0f) _sweep_angle -= 360.0f;

        // Follow the active location (Home or a saved airport) — cheap check,
        // no per-view "on_show" hook exists for Radar so this runs every tick.
        int active = locations_active_index();
        if (active != _last_active_loc) {
            _last_active_loc = active;
            float lat, lon;
            int elev;
            if (locations_get_active_coords(&lat, &lon, &elev)) {
                _proj.center_lat = lat;
                _proj.center_lon = lon;
            }
            _list = locations_active_list(_home_list);
        }

        // Only update when range actually changes
        float r = range_get_nm();
        if (r != _last_range) {
            _last_range = r;
            _proj.radius_nm = r;
        }

        // Sync filter button visuals if filter changed from another view
        unsigned af = filter_get_active();
        if (af != _last_synced_filter) {
            _last_synced_filter = af;
            update_filter_visuals();
        }
        if (g_config.view_hide_ground[VIEW_RADAR] != _last_synced_gnd) {
            _last_synced_gnd = g_config.view_hide_ground[VIEW_RADAR];
            update_gnd_visual();
        }

        // Skip rendering when touch is active — use global flag (lv_indev_active() is null in timers)
        if (touch_active) return;

        // Only invalidate when radar view is active
        if (views_get_active_index() == VIEW_RADAR) {
            lv_obj_invalidate(_radar_obj);
        }
    }, 100, nullptr);  // 10fps — frees CPU for touch processing
}

void radar_view_update() {
    if (_radar_obj) lv_obj_invalidate(_radar_obj);
}

// Called from the shared status bar chip (status_bar.cpp) when Radar is the
// active tab. Only affects this view's own drawing cutoff -- Map and Radar
// share the same underlying Aircraft/TrailPoint data, so this must never
// mutate it (that would clear both views at once).
void radar_view_clear_trails() {
    _trails_cleared_at = millis();
    if (_radar_obj) lv_obj_invalidate(_radar_obj);
}

void radar_view_set_home(float lat, float lon) {
    _proj.center_lat = lat;
    _proj.center_lon = lon;
    if (_radar_obj) lv_obj_invalidate(_radar_obj);
}
